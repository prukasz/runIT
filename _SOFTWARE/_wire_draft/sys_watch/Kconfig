## _SOFTWARE/_wire_draft/sys_watch/Kconfig
```kconfig
# What step 4 adds to components/sys/sys_watch/Kconfig (inside its menu):

    config SYS_WATCH_CLIENT_MAX
        int "Watches on other boards"
        default 24
        range 1 64
        help
          Watches this board added on other boards (each read of a remote
          device is one): the board, the id and where its entries go.

    config SYS_WATCH_IDLE_MIN_MS
        int "Cached read idle floor (ms)"
        default 1000
        range 100 600000
        help
          A cached read's watch is removed on its board after 10 times its
          max age without a read, never sooner than this: a fast reader's
          pause does not remove and make it again.
```

## _SOFTWARE/components/VM/Kconfig
```kconfig
menu "VM Configuration"

    menu "VM Execution & Scheduling"

        config VM_EXEC_TASK_PRIO
            int "Supervisor task priority"
            default 5
            help
                FreeRTOS task priority for the VM execution supervisor.

        config VM_EXEC_TASK_CORE
            int "Supervisor task pinned core"
            default 1
            help
                Core affinity for VM supervisor task (default 1 to keep core 0 free for BLE).

        config VM_EXEC_MAX_SPAN_DEPTH
            int "Maximum nested execution span depth"
            default 4
            help
                Maximum nested loop/span depth allowed during block execution.

        config VM_EXEC_BLOCK_WD_MS
            int "Block watchdog timeout (ms)"
            default 20
            help
                Maximum duration in milliseconds a single block may execute before timing out.

        config VM_EVENT_DEPTH
            int "VM incoming event queue depth"
            default 16
            help
                Capacity of the ring buffer receiving events between cycles.

        config VM_OVERRIDE_BUF_SIZE
            int "VM variable override ring buffer size (bytes)"
            default 1024
            help
                Byte capacity of the runtime variable override ring buffer.

    endmenu

    menu "VM Retained Values"

        config VM_RETAIN_PERIOD_S
            int "Save period (s)"
            default 60
            range 5 3600
            help
                How often the values of retentive objects are saved to flash,
                if any changed. Also saved on program teardown and on the safe
                state; an unplanned power loss loses at most one period.

        config VM_RETAIN_MAX_BYTES
            int "Maximum retained bytes"
            default 1024
            range 64 8192
            help
                Size of the stored record (2 + per object: 4 + name + value).
                A program retaining more is refused at load
                (ERR_VM_RETAIN_TOO_BIG). Costs twice this in RAM.

        config VM_RETAIN_TASK_STACK
            int "Retain task stack (bytes)"
            default 3072
            range 2048 8192
            help
                Stack of the low-priority task that writes retained values
                to flash, off the VM task.

        config VM_RETAIN_TASK_PRIO
            int "Retain task priority"
            default 2
            range 1 24
            help
                Priority of the retain task; below the VM supervisor.

    endmenu

    menu "VM Block & Memory Limits"

        config VM_BLOCK_MAX_IN
            int "Maximum input accessors per block"
            default 16
            help
                Maximum number of input accessors allowed for a single VM execution block.

        config VM_BLOCK_MAX_OUT
            int "Maximum output objects per block"
            default 16
            help
                Maximum number of output objects allowed for a single VM execution block.

        config VM_BLOCK_MAX_EN
            int "Maximum enable accessors per block"
            default 16
            help
                Maximum number of enable accessors allowed for a single VM execution block.

        config VM_STORE_MAX_POOL
            int "Maximum program arena pool size (bytes)"
            default 131072
            help
                Hard ceiling in bytes for the bump-allocated program storage arena.

        config VM_ACCESSOR_MAX_DEPTH
            int "Maximum accessor path resolution depth"
            default 8
            help
                Maximum chain depth when resolving nested accessor paths.

        config VM_OBJ_COPY_MAX_DEPTH
            int "Maximum object copy recursion depth"
            default 8
            help
                Maximum tree recursion depth allowed when copying objects.

        config VM_DYN_MAX
            int "Maximum concurrent dynamic objects"
            default 128
            help
                Upper ceiling of live dynamically registered objects on the heap.

        config VM_DYN_MAX_DEPTH
            int "Maximum dynamic DAG ownership depth"
            default 16
            help
                Maximum allowed ownership path depth in dynamic object graph.

        config VM_SUB_MAX_SUBSCRIBERS
            int "Maximum subscribed object IDs"
            default 128
            help
                Maximum count of object IDs that can be subscribed to simultaneously.

        config VM_SUB_MAX_FRAME_LEN
            int "Maximum telemetry frame length (bytes)"
            default 512
            help
                Maximum byte size of a generated telemetry output packet.

        config VM_SUB_MAX_EMITTED_PER_PASS
            int "Maximum emitted update objects per pass"
            default 256
            help
                Maximum count of updated object IDs processed in a single scan pass.

    endmenu

endmenu
```

## _SOFTWARE/components/app/runit/Kconfig
```kconfig
menu "runIT"

    config RUNIT_BLE_START
        bool "Start BLE at boot"
        default y
        help
          Off for QEMU: it emulates no Bluetooth controller (the controller
          init asserts). The runIT GATT table, the BLE router link and the BLE
          stream bindings are still set up; only NimBLE is not started.
          sdkconfig.qemu.defaults turns it off for the QEMU build.

    config RUNIT_ONBOARD_DEVICES
        bool "Create the onboard devices at boot"
        default y
        help
          The runIT PCB: the ESP GPIO, the TCA6424A expander (status LED lit)
          and every other onboard chip (power muxes, ADS7128, PCA9685, both
          TPS55289 rails, INA3221, AP33772S, DAC53202, both DRV8962). Off for a
          devkit or QEMU (no chips; the test suites create devices themselves).

    menu "Onboard action IDs"

        config RUNIT_ACTION_ID_RESUME
            int "Resume all devices"
            default 3
            range 1 255
            help
              ID of the onboard action that resumes every device. The firmware
              writes it at every boot (replacing a stored action with this ID).

        config RUNIT_ACTION_ID_SUSPEND
            int "Suspend all devices"
            default 4
            range 1 255
            help
              ID of the onboard action that suspends every device. The firmware
              writes it at every boot (replacing a stored action with this ID).

        config RUNIT_ACTION_ID_RESET
            int "Reset all devices"
            default 5
            range 1 255
            help
              ID of the onboard action that resets every device (RESET sweep,
              newest first). The firmware writes it at every boot.

        config RUNIT_ACTION_ID_HARD_RESET
            int "Hard reset (restart the board)"
            default 6
            range 1 255
            help
              ID of the onboard action that restarts the board (sys RESTART).
              The firmware writes it at every boot.

    endmenu

endmenu
```

## _SOFTWARE/components/core/router/Kconfig
```kconfig
menu "router"

    config ROUTER_FRAME_MAX
        int "Largest frame (bytes)"
        default 512
        range 64 4096
        help
          Largest request frame accepted from a link, and the largest response
          frame built (stream byte included). A link may report a smaller
          limit at runtime (BLE MTU).

    config ROUTER_RESPONSE_STREAM
        hex "Response stream byte"
        default 0x05
        range 0x00 0xFF
        help
          First byte of every response frame, so clients can tell answers from
          other streams on the same link.

    config ROUTER_MAX_KEYS
        int "Root keys"
        default 16
        range 2 64
        help
          Root table slots (router_register).

    config ROUTER_MAX_LINKS
        int "Highest link ID"
        default 4
        range 1 16
        help
          Links are registered under IDs 1..ROUTER_MAX_LINKS (router_ids.h).

    config ROUTER_WORK_QUEUE_SIZE
        int "Work queue (bytes)"
        default 4096
        range 1024 32768
        help
          Ring buffer for normal frames waiting for the work task. Each frame
          takes its length plus 16 bytes. Multiple of 4.

    config ROUTER_URGENT_QUEUE_SIZE
        int "Urgent queue (bytes)"
        default 1024
        range 256 8192
        help
          Ring buffer for frames flagged urgent. Multiple of 4.

    config ROUTER_WORK_TASK_PRIO
        int "Work task priority"
        default 5
        range 1 24

    config ROUTER_WORK_TASK_STACK
        int "Work task stack (bytes)"
        default 6144
        range 3072 32768
        help
          Runs the module routers of normal frames.

    config ROUTER_URGENT_TASK_PRIO
        int "Urgent task priority"
        default 15
        range 1 24
        help
          Above every task that may run a long command, so an urgent frame
          (stop) never waits behind one.

    config ROUTER_URGENT_TASK_STACK
        int "Urgent task stack (bytes)"
        default 6144
        range 3072 32768
        help
          Runs urgent frames and the safe-state handler.

    config ROUTER_ERR_REQ_MAX
        int "Request bytes kept in an error record"
        default 32
        range 0 127
        help
          How much of the failing request (keys + payload) an error record
          repeats. Longer requests are cut and marked.

    config ROUTER_DEADMAN_DEFAULT_MS
        int "Dead-man timeout at boot (ms, 0 = off)"
        default 0
        range 0 600000
        help
          Changed at runtime with the sys DEADMAN_SET command; not stored.

endmenu
```

## _SOFTWARE/components/runit/Kconfig
```kconfig
menu "runIT Board & Diagnostic Configuration"

    config RUNIT_UART_CONSOLE_LINK
        bool "Command link on the console UART"
        default y
        help
            Registers the console UART as a data connector provider and binds
            the interface (commands in, responses out), telemetry and error
            packet connectors to it, next to BLE. Frames are "#R:<hex>" lines
            mixed with the text log (sys_uart_provider.h). Used by the host
            test scripts; disable to keep the console log-only.

endmenu
```

## _SOFTWARE/components/runit_kernel/Kconfig
```kconfig
menu "RunIT Configurations"

    menu "Device Connectivity"
        config CONNECT_TCA6424A
            bool "Connect TCA6424A"
            default y
        config CONNECT_TPS55289_0
            bool "Connect TPS55289_0"
            default y
        config CONNECT_TPS55289_1
            bool "Connect TPS55289_1"
            default y
        config CONNECT_INA3221
            bool "Connect INA3221"
            default y
        config CONNECT_ADS7128
            bool "Connect ADS7128"
            default y
        config CONNECT_PCA9685
            bool "Connect PCA9685"
            default y
    endmenu

    menu "Mock Drivers (for testing without hardware)"
        config USE_MOCK_TCA6424A
            bool "Use mock TCA6424A driver"
            default y
        config USE_MOCK_TPS55289
            bool "Use mock TPS55289 driver"
            default y
        config USE_MOCK_ADS7128
            bool "Use mock ADS7128 driver"
            default y
    endmenu

    menu "I2C Addresses"
        config I2C_ADDR_TCA6424A
            int "TCA6424A (0x23 to 3v5, 0x22 to GND)"
            default 35
        config I2C_ADDR_INA3221
            int "INA3221 (0x40 only)"
            default 64
        config I2C_ADDR_PCA9685
            int "PCA9685 (0x70 to 3v5, 0x60 to GND)"
            default 96
        config I2C_ADDR_ADS7128
            int "ADS7128 (0x10 float, 0x17 to decap)"
            default 16
        config I2C_ADDR_TPS55289_0
            int "TPS55289_0"
            default 116
        config I2C_ADDR_TPS55289_1
            int "TPS55289_1"
            default 117
        config I2C_ADDR_DAC5202
            int "DAC5202"
            default 72
        config I2C_ADDR_AP33772S
            int "AP33772S"
            default 82
    endmenu

    menu "Hardware Configuration"
        config DRV_0_RISE_MODE
            int "Driver 0 rise mode (0=140ns, 1=70ns)"
            default 0
        config DRV_1_RISE_MODE
            int "Driver 1 rise mode (0=140ns, 1=70ns)"
            default 0
        config TPS55289_1_MAX_VOLTAGE
            int "TPS55289_1 max voltage (mV) - supply for PWM expander, <6V recommended with servos"
            default 6000
        
    endmenu

    menu "ESP GPIO / ADC Settings"
        config ESP_ADC_SAMPLE_RATE_HZ
            int "Sampling rate for ESP ADC (Hz)"
            default 20000
        config ESP_ADC_FRAME_SIZE_BYTES
            int "Size of each ADC data frame (bytes)"
            default 800
        config ESP_ADC_IIR_ALPHA 
            float "IIR filter alpha for ESP ADC"
            default 0.5
        config ESP_GPIO_DEBOUNCE_TIME_US
            int "Debounce time for GPIO interrupts (microseconds)"
            default 5000
        config PRIORITY_ESP_ADC_TASK
            int "Priority of the ESP ADC task"
            default 10
        config MAX_PENDING_GPIO_ESP_INTR
            int "Maximum pending GPIO ESP interrupts in queue"
            default 10
    endmenu


    menu "Task Priorities"
        config PRIORITY_STATUS_TASK
            int "Priority of the status handler task"
            default 24
        config PRIORITY_INTERFACE_TASK
            int "Priority of the main interface task"
            default 22
        config PRIORITY_I2C_MANAGER_TASK
            int "Priority of the I2C manager task"
            default 21
        config PRIORITY_BLE_MANAGER_TASK
            int "Priority of the BLE manager task"
            default 22
        config PRIORITY_TCA6424A_TASK
            int "Priority of the TCA6424A task"
            default 20
    endmenu

    menu "Buffer Sizes"
        config BUFFER_SIZE_STATUS_REP
            int "Size of the status reports buffer (bytes)"
            default 2048
        config BUFFER_SIZE_TX
            int "Size of the transmission buffer (bytes)"
            default 2048
        config BUFFER_SIZE_RX
            int "Size of the reception buffer (bytes)"
            default 2048
        config BUFFER_SIZE_ESP_LOG
            int "Size of the ESP log buffer (bytes)"
            default 4096
        config MAX_PENDING_STATUS_REP
            int "Maximum pending status reports in queue"
            default 20
    endmenu

endmenu
```
