## _SOFTWARE/components/system/ble/Kconfig
```kconfig
menu "System Configuration"

    menu "BLE Manager Options"
        config SYS_BLE_MANAGER_TASK_PRIO
            int "BLE Manager Task Priority"
            default 5
            range 1 24
            help
              Priority of the BLE manager task.

        config SYS_BLE_TASK_STACK_SIZE
            int "BLE Task Stack Size (bytes)"
            default 4096
            range 1024 32768
            help
              Stack size in bytes for the BLE manager task.

        config SYS_BLE_GAP_APPEARANCE
            hex "GAP Appearance Value"
            default 0x0200
            range 0x0000 0xFFFF
            help
              GAP appearance value advertised in the BLE advertising fields
              (0x0200 = Generic Tag).

        config SYS_BLE_MAX_LINKED_CONNECTORS
            int "Maximum Linked Connectors per Characteristic"
            default 2
            range 1 8
            help
              Maximum number of data connectors that can be linked to a
              single BLE characteristic.

    endmenu

    menu "Callbacks System Options"
        config SYS_CB_QUEUE_LEN
            int "Callback Event Queue Length"
            default 16
            range 4 256
            help
              Queue capacity for callback event dispatcher.

        config SYS_CB_TASK_STACK_SIZE
            int "Callback Task Stack Size (bytes)"
            default 4096
            range 1024 32768
            help
              Stack size in bytes for callback task.

        config SYS_CB_TASK_PRIO
            int "Callback Task Priority"
            default 5
            range 1 24
            help
              Priority of callback task.

        config SYS_CB_ROUTE_COUNT
            int "Callback Route Table Slots"
            default 16
            range 1 16
            help
              Route table size (number of callback routing slots).

        config SYS_CB_ROUTE_IO
            int "sys_io Callback Route Slot"
            default 0
            range 0 15
            help
              Route slot index for sys_io's own callback-event handler.

        config SYS_CB_ROUTE_BLE
            int "BLE Callback Route Slot"
            default 1
            range 0 15
            help
              Route slot index for ble's own callback-event handler.

        config SYS_CB_ROUTE_PWR
            int "sys_power Callback Route Slot"
            default 2
            range 0 15
            help
              Route slot index for sys_power's own callback-event handler.

        config SYS_CB_ROUTE_WIFI
            int "WiFi Callback Route Slot"
            default 3
            range 0 15
            help
              Route slot index for WiFi handling (not implemented yet).

        config SYS_CB_ROUTE_VM
            int "VM Callback Route Slot"
            default 4
            range 0 15
            help
              Route slot index for the VM's per-scan-cycle event buffer. Unlike
              the routes above, this one does not handle the event - it parks
              it for the length of one scan cycle so blocks can query it, then
              drops it. See VM_EXEC.MD.
    endmenu

    menu "System Actions Options"
        config SYS_ACTIONS_TAP_BUFFER_SIZE
            int "Actions Tap Buffer Size (bytes)"
            default 1024
            range 128 16384
            help
              Actions tap ring buffer capacity in bytes.

        config SYS_ACTIONS_TAP_TASK_STACK
            int "Actions Tap Task Stack Size (bytes)"
            default 4096
            range 1024 32768
            help
              Stack size in bytes for actions tap task.

        config SYS_ACTIONS_TAP_TASK_PRIO
            int "Actions Tap Task Priority"
            default 4
            range 1 24
            help
              Priority of actions tap task.

        config SYS_ACTIONS_TAP_POLL_MS
            int "Actions Tap Poll Interval (ms)"
            default 20
            range 1 1000
            help
              Polling interval in milliseconds for actions tap task.

        config SYS_ACTIONS_ID_SPACE
            int "Total Action ID Space Size"
            default 64
            range 8 256
            help
              Total action ID space (0..ID_SPACE-1).

        config SYS_ACTIONS_STATIC_SLOTS
            int "Static Action Slots Count"
            default 16
            range 1 64
            help
              Number of static action slots (0..STATIC_SLOTS-1).

        config SYS_ACTIONS_MAX_BLOB_SIZE
            int "Maximum Dynamic Action Blob Size (bytes)"
            default 2048
            range 128 16384
            help
              Maximum blob size per dynamic action.

        config SYS_ACTION_ID_BOOT
            int "Boot Static Action ID"
            default 1
            range 1 255
            help
              Default static action slot ID for the boot action.

        config SYS_ACTION_ID_FREEZE
            int "Freeze Static Action ID"
            default 2
            range 1 255
            help
              Default static action slot ID for the freeze action.

        config SYS_ACTION_ID_RESUME
            int "Resume Static Action ID"
            default 3
            range 1 255
            help
              Default static action slot ID for the resume action.

        config SYS_ACTION_ID_SUSPEND
            int "Suspend Static Action ID"
            default 4
            range 1 255
            help
              Default static action slot ID for the suspend action.

        config SYS_ACTION_ID_RESET
            int "Reset Static Action ID"
            default 5
            range 1 255
            help
              Default static action slot ID for the reset action.

        config SYS_ACTION_ID_HARD_RESET
            int "Hard Reset Static Action ID"
            default 6
            range 1 255
            help
              Default static action slot ID for the hard-reset action.
    endmenu

    menu "System Device Options"
        config SYS_DEVICE_MAX_ID
            int "Maximum Device ID"
            default 127
            range 15 255
            help
              Maximum allowable device ID in system registry.
    endmenu

    menu "System I2C Options"
        config SYS_I2C_DEFAULT_TIMEOUT_MS
            int "Default I2C Timeout (ms)"
            default 50
            range 5 5000
            help
              Default timeout in ms for I2C master transmit/receive operations.
    endmenu

    menu "System Interface Options"
        config SYS_INTERFACE_RX_TASK_STACK_SIZE
            int "RX Receiver Task Stack Size (bytes)"
            default 4096
            range 1024 32768
            help
              Stack size in bytes for shared RX receiver task.

        config SYS_INTERFACE_RX_TASK_PRIO
            int "RX Receiver Task Priority"
            default 5
            range 1 24
            help
              Priority of shared RX receiver task.

        config SYS_INTERFACE_RX_WAIT_MS
            int "RX Receiver Task Wait/Poll Period (ms)"
            default 100
            range 10 1000
            help
              Wait/poll period in ms for RX receiver task.

        config SYS_INTERFACE_MAX_CLASSES
            int "Maximum Registered Class Handlers"
            default 8
            range 2 32
            help
              Maximum number of registered class handlers.

        config SYS_INTERFACE_RX_FRAME_CAP
            int "Maximum RX Frame Capacity (bytes)"
            default 512
            range 64 4096
            help
              Maximum frame size accepted by RX receiver.
    endmenu

    menu "System Data Connector Options"
        config SYS_DATA_CONNECTOR_MAX
            int "Maximum Connectors in Registry"
            default 8
            range 1 32
            help
              Maximum number of data connectors in the system registry.

        config SYS_DATA_PROVIDER_MAX
            int "Maximum Providers in Registry"
            default 8
            range 1 32
            help
              Maximum number of transport providers in the registry.

        config SYS_DATA_CONNECTOR_PROVIDERS_MAX
            int "Maximum Providers per Connector (TX/RX)"
            default 4
            range 1 16
            help
              Maximum number of providers that can be attached to a single connector
              for fan-out (TX) or fan-in (RX).

        config SYS_DATA_CONNECTOR_NAME_MAX
            int "Maximum Connector Name Length"
            default 16
            range 8 64
            help
              Maximum length of diagnostic name string per connector.

        config SYS_DATA_CONNECTOR_MAX_PACKET_LEN
            int "Maximum Packet Length (bytes)"
            default 512
            range 64 4096
            help
              Default compile-time maximum packet / frame length for data connectors.

        config SYS_DATA_HEADER_STATUS
            hex "Status Packet Framing Header Byte"
            default 0x01
            range 0x00 0xFF
            help
              Outer framing header byte for status packets.

        config SYS_DATA_HEADER_TX
            hex "TX / Data Packet Framing Header Byte"
            default 0x02
            range 0x00 0xFF
            help
              Outer framing header byte for TX data packets.

        config SYS_DATA_HEADER_LOGS
            hex "Logs Framing Header Byte"
            default 0x03
            range 0x00 0xFF
            help
              Outer framing header byte for text log packets.

        config SYS_DATA_HEADER_ERRORS
            hex "Errors Telemetry Framing Header Byte"
            default 0x04
            range 0x00 0xFF
            help
              Outer framing header byte for binary error telemetry packets.
    endmenu

    menu "System Errors Options"
        config SYS_ERRORS_BUF_SIZE
            int "Error Pool Buffer Size (bytes)"
            default 1024
            range 128 8192
            help
              Total size of the bounded error node allocator's backing buffer.

        config SYS_ERRORS_BLOCK_SIZE
            int "Error Pool Block Size (bytes)"
            default 32
            range 8 256
            help
              Allocation granularity of the error node pool. SYS_ERRORS_BUF_SIZE
              must be evenly divisible by this value.

        config SYS_ERRORS_LOG_LINE_MAX
            int "Log Line Stack Buffer Size (bytes)"
            default 512
            range 64 4096
            help
              Stack buffer size the log hook renders one line into.

        config SYS_ERRORS_PACKET_MAX
            int "Error Packet Buffer Size (bytes)"
            default 512
            range 64 4096
            help
              Compile-time ceiling for binary error packet buffer.

        config SYS_ERRORS_CONNECTOR_ID_LOGS
            int "Text Log Connector ID"
            default 0
            range 0 15
            help
              Static system connector ID for outbound text logs.

        config SYS_ERRORS_CONNECTOR_ID_ERRORS
            int "Error Telemetry Connector ID"
            default 1
            range 0 15
            help
              Static system connector ID for outbound binary error telemetry.
    endmenu

    menu "System Power Management Options"
        config SYS_POWER_DEFAULT_LIMIT_MV
            int "Default Power Voltage Limit (mV)"
            default 21000
            range 0 50000
            help
              Default system power voltage limit in mV.

        config SYS_POWER_DEFAULT_LIMIT_MA
            int "Default Power Current Limit (mA)"
            default 5500
            range 0 20000
            help
              Default system power current limit in mA.

        config SYS_POWER_DEFAULT_BUDGET_MW
            int "Default Power Budget Limit (mW)"
            default 115500
            range 0 1000000
            help
              Default system power budget limit in mW.
    endmenu

endmenu
```

## _SOFTWARE/components/system/callbacks/Kconfig
```kconfig
menu "Callbacks System Options"
    config SYS_CB_QUEUE_LEN
        int "Callback Event Queue Length"
        default 16
        range 4 256
        help
          Queue capacity for callback event dispatcher.

    config SYS_CB_TASK_STACK_SIZE
        int "Callback Task Stack Size (bytes)"
        default 4096
        range 1024 32768
        help
          Stack size in bytes for callback task.

    config SYS_CB_TASK_PRIO
        int "Callback Task Priority"
        default 5
        range 1 24
        help
          Priority of callback task.

    config SYS_CB_ROUTE_COUNT
        int "Callback Route Table Slots"
        default 16
        range 1 16
        help
          Route table size (number of callback routing slots). See
          components/utils/Kconfig's "System-Wide Identity Assignments" for
          the individual route slot index assignments.
endmenu
```

## _SOFTWARE/components/system/sys_actions/Kconfig
```kconfig
menu "System Actions Options"
    config SYS_ACTIONS_TAP_BUFFER_SIZE
        int "Actions Tap Buffer Size (bytes)"
        default 1024
        range 128 16384
        help
          Actions tap ring buffer capacity in bytes.

    config SYS_ACTIONS_TAP_TASK_STACK
        int "Actions Tap Task Stack Size (bytes)"
        default 4096
        range 1024 32768
        help
          Stack size in bytes for actions tap task.

    config SYS_ACTIONS_TAP_TASK_PRIO
        int "Actions Tap Task Priority"
        default 4
        range 1 24
        help
          Priority of actions tap task.

    config SYS_ACTIONS_TAP_POLL_MS
        int "Actions Tap Poll Interval (ms)"
        default 20
        range 1 1000
        help
          Polling interval in milliseconds for actions tap task.

    config SYS_ACTIONS_ID_SPACE
        int "Total Action ID Space Size"
        default 64
        range 8 256
        help
          Total action ID space (0..ID_SPACE-1).

    config SYS_ACTIONS_STATIC_SLOTS
        int "Static Action Slots Count"
        default 16
        range 1 64
        help
          Number of static action slots (0..STATIC_SLOTS-1). See
          components/utils/Kconfig's "System-Wide Identity Assignments" for
          the individual default static action ID assignments.

    config SYS_ACTIONS_MAX_BLOB_SIZE
        int "Maximum Dynamic Action Blob Size (bytes)"
        default 2048
        range 128 16384
        help
          Maximum blob size per dynamic action.
endmenu
```

## _SOFTWARE/components/system/sys_data_connector/Kconfig
```kconfig
menu "System Data Connector Options"
    config SYS_DATA_CONNECTOR_MAX
        int "Maximum Connectors in Registry"
        default 8
        range 1 32
        help
          Maximum number of data connectors in the system registry.

    config SYS_DATA_PROVIDER_MAX
        int "Maximum Providers in Registry"
        default 8
        range 1 32
        help
          Maximum number of transport providers in the registry.

    config SYS_DATA_CONNECTOR_PROVIDERS_MAX
        int "Maximum Providers per Connector (TX/RX)"
        default 4
        range 1 16
        help
          Maximum number of providers that can be attached to a single connector
          for fan-out (TX) or fan-in (RX).

    config SYS_DATA_CONNECTOR_NAME_MAX
        int "Maximum Connector Name Length"
        default 16
        range 8 64
        help
          Maximum length of diagnostic name string per connector.

    config SYS_DATA_CONNECTOR_MAX_PACKET_LEN
        int "Maximum Packet Length (bytes)"
        default 512
        range 64 4096
        help
          Default compile-time maximum packet / frame length for data connectors.
endmenu
```
