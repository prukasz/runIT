## _SOFTWARE/components/system/sys_device/Kconfig
```kconfig
menu "System Device Options"
    config SYS_DEVICE_MAX_ID
        int "Maximum Device ID"
        default 127
        range 15 255
        help
          Maximum allowable device ID in system registry.
endmenu
```

## _SOFTWARE/components/system/sys_event/Kconfig
```kconfig
menu "Events (sys_event)"
    config SYS_EVENT_MAX_SUBSCRIPTIONS
        int "Subscription Table Size"
        default 32
        range 4 32
        help
          Listeners that can be registered at once: device IRQ chaining,
          the power manager, features and packet subscriptions share it.
          Each entry takes about 20 bytes.

    config SYS_EVENT_MAX_HOPS
        int "Maximum Republish Depth"
        default 4
        range 1 16
        help
          A listener that republishes passes the depth on (SYS_EVENT_CAUSED_BY).
          An event at this depth is dropped with ERR_EVENT_LOOP, which stops
          publish -> listener -> publish loops and bounds inline recursion.

    config SYS_EVENT_QUEUE_LEN
        int "Event Queue Length"
        default 16
        range 4 256
        help
          Events waiting for queued listeners (and ISR events waiting for
          any listener).

    config SYS_EVENT_TASK_STACK_SIZE
        int "Event Task Stack Size (bytes)"
        default 4096
        range 1024 32768
        help
          Stack of the event task, which runs queued listeners, routes,
          actions, and the inline listeners of ISR events.

    config SYS_EVENT_TASK_PRIO
        int "Event Task Priority"
        default 5
        range 1 24

    config SYS_EVENT_ROUTE_COUNT
        int "Route Slots"
        default 8
        range 1 8
        help
          Route table size. See components/utils/Kconfig "System-Wide
          Identity Assignments" for the slot indices.
endmenu
```

## _SOFTWARE/components/system/sys_i2c/Kconfig
```kconfig
menu "System I2C Options"
    config SYS_I2C_DEFAULT_TIMEOUT_MS
        int "Default I2C Timeout (ms)"
        default 50
        range 5 5000
        help
          Default timeout in ms for I2C master transmit/receive operations.
endmenu
```

## _SOFTWARE/components/system/sys_interface/Kconfig
```kconfig
menu "System Interface Options"
    config SYS_INTERFACE_RX_TASK_STACK_SIZE
        int "RX Receiver Task Stack Size (bytes)"
        default 4096
        range 1024 32768
        help
          Stack size in bytes for shared RX receiver task.

    config SYS_INTERFACE_RX_TASK_PRIO
        int "RX Receiver Task Priority"
        default 5
        range 1 24
        help
          Priority of shared RX receiver task.

    config SYS_INTERFACE_RX_WAIT_MS
        int "RX Receiver Task Wait/Poll Period (ms)"
        default 100
        range 10 1000
        help
          Wait/poll period in ms for RX receiver task.

    config SYS_INTERFACE_MAX_CLASSES
        int "Maximum Registered Class Handlers"
        default 12
        range 2 32
        help
          Maximum number of registered class handlers.

    config SYS_INTERFACE_RESPONSE_MAX
        int "Maximum Response Data (bytes)"
        default 128
        range 16 1024
        help
          Capacity for the data a decoder attaches to one command's response
          (sys_interface_respond()), not counting the 4-byte response header (seq, class, packet, status).
          The largest response today is the USB-PD option list (106 bytes).
          A response longer than the origin transport's current frame limit
          (BLE: MTU - 3) is answered with an error status instead.
endmenu
```

## _SOFTWARE/components/system/sys_power/Kconfig
```kconfig
menu "System Power Management Options"
    config SYS_POWER_TASK_STACK_SIZE
        int "Power Manager Task Stack Size (bytes)"
        default 4096
        range 2048 16384
        help
          Stack of the power manager task (source detection, budget,
          battery estimate).

    config SYS_POWER_TASK_PRIO
        int "Power Manager Task Priority"
        default 4
        range 1 24
        help
          Priority of the power manager task.

    config SYS_POWER_TASK_PERIOD_MS
        int "Power Manager Period (ms)"
        default 1000
        range 100 10000
        help
          How often the manager measures the input, re-detects the source and
          updates the budget and battery estimate. Settings changes wake it
          immediately.

    config SYS_POWER_MAX_CONSUMERS
        int "Maximum Budgeted Rails"
        default 4
        range 1 16
        help
          Most vreg rails a board description can list under the budget.

    config SYS_POWER_BUDGET_STEP_MW
        int "Budget Change Threshold (mW)"
        default 250
        range 0 10000
        help
          The automatic rail caps are recomputed when the budget changes by at
          least this much, so measurement noise on the input voltage doesn't
          reprogram the regulators every period.

    config SYS_POWER_INPUT_WARNING_PCT
        int "Input Current Warning (% of source limit)"
        default 90
        range 10 99
        help
          The input monitor's warning alert is set at this share of the
          source's current limit; the critical alert is at the limit itself.

    config SYS_POWER_BATTERY_HYSTERESIS_PCT
        int "Battery Threshold Hysteresis (%)"
        default 3
        range 1 20
        help
          A battery low/critical event is raised once and re-armed only when
          the charge rises this far above the threshold.
endmenu
```
