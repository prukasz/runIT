## _SOFTWARE/components/sys/sys_actions/Kconfig
```kconfig
menu "sys_actions"

    config SYS_ACTIONS_PARTITION
        string "NVS partition"
        default "project"
        help
          NVS data partition (partitions.csv) whose "actions" namespace holds
          the stored actions, one blob per action (name + image), key "a<id>".

    config SYS_ACTIONS_MAX_BYTES
        int "Largest action (bytes)"
        default 4096
        range 256 16384
        help
          Largest image (frames with their u16 length). Also the static buffer
          a recording or upload is built in (+ 16 bytes for the name).

    config SYS_ACTIONS_MAX_DEPTH
        int "Nested runs"
        default 3
        range 1 8
        help
          How deep a RUN inside an action may nest. Each level holds its image
          and a router frame of heap, and a few hundred bytes of the router
          task's stack.

endmenu
```

## _SOFTWARE/components/sys/sys_ble/Kconfig
```kconfig
menu "sys_ble"

    config SYS_BLE_DEVICE_NAME
        string "Device name"
        default "runit"
        help
          GAP name the board advertises.

    config SYS_BLE_GAP_APPEARANCE
        hex "GAP appearance"
        default 0x0200
        range 0x0000 0xFFFF
        help
          Appearance value in the advertising data (0x0200 = Generic Tag).

    config SYS_BLE_TASK_PRIO
        int "BLE task priority"
        default 5
        range 1 24
        help
          Task that sends queued TX items (notifications / indications) and
          applies staged GATT changes.

    config SYS_BLE_TASK_STACK
        int "BLE task stack (bytes)"
        default 4096
        range 2048 32768

    config SYS_BLE_TX_ITEM_MAX
        int "Largest TX item (bytes)"
        default 512
        range 64 4096
        help
          Largest item the BLE task sends (a framed characteristic splits it
          into packets). Must hold a whole router frame (ROUTER_FRAME_MAX).
          Static buffer of this size.

    config SYS_BLE_APPLY_DELAY_MS
        int "Apply delay with a client connected (ms)"
        default 200
        range 0 5000
        help
          sys_ble_apply() with a client connected waits this long, so the
          command that asked for it is answered before the Service Changed
          indication.

    config SYS_BLE_MAX_CONN_LISTENERS
        int "Connection listeners"
        default 4
        range 1 16

endmenu
```

## _SOFTWARE/components/sys/sys_connector/Kconfig
```kconfig
menu "sys_connector"

    config SYS_CONNECTOR_MAX
        int "Connectors"
        default 8
        range 5 32
        help
          Registry slots: 4 system connectors (logs, errors, telemetry,
          events) and user connectors from SYS_CONNECTOR_APP_BASE (4).

    config SYS_CONNECTOR_BINDINGS
        int "Bindings per connector"
        default 3
        range 1 8

    config SYS_CONNECTOR_PROVIDERS_MAX
        int "Highest provider ID"
        default 4
        range 2 16
        help
          Providers register under their transport ID 1..this.

    config SYS_CONNECTOR_FRAME_MAX
        int "Largest frame (bytes)"
        default 512
        range 64 4096
        help
          Largest frame (stream byte included) a connector sends. Static
          buffer of this size in the connector task.

    config SYS_CONNECTOR_QUEUE_SIZE
        int "Queue (bytes)"
        default 4096
        range 1024 32768
        help
          Ring buffer of payloads waiting for the connector task; each takes
          its length + ~12 bytes. A full queue drops sends. Multiple of 4.

    config SYS_CONNECTOR_TASK_PRIO
        int "Task priority"
        default 4
        range 1 24
        help
          Below the router tasks: streams wait, commands don't.

    config SYS_CONNECTOR_TASK_STACK
        int "Task stack (bytes)"
        default 4096
        range 2048 32768

    config SYS_CONNECTOR_LOG_LINE_MAX
        int "Captured log line (bytes)"
        default 160
        range 32 480
        help
          Log lines sent to the logs connector are cut to this. Formatted on
          the stack of the task that logs.

endmenu
```

## _SOFTWARE/components/sys/sys_device/Kconfig
```kconfig
menu "sys_device"

    config SYS_DEVICE_MAX
        int "Registered devices"
        default 32
        range 1 1024
        help
          How many devices can be registered at once (any IDs 0..0xFFFE).
          One entry is an ID, a type, its struct pointer and its error policy.

    config SYS_DEVICE_TYPES
        int "Device types"
        default 16
        range 1 255
        help
          Device types that can be registered.

    config SYS_DEVICE_MAX_DEPS
        int "Devices one device may use"
        default 4
        range 1 16
        help
          Distinct devices one device declares with sys_device_use() (the
          devices its pins are on, ...). Pins on the same device count once.

    config SYS_DEVICE_GUARDS
        int "Contract guards"
        default 2
        range 1 8
        help
          Contracts that can have a guard (sys_device_set_guard): a module
          that sees every call of the contract's ops before the device does
          (the power manager guards POWER_VREG).

endmenu
```

## _SOFTWARE/components/sys/sys_event/Kconfig
```kconfig
menu "sys_event"

    config SYS_EVENT_MAX_SUBS
        int "Subscriptions (C)"
        default 32
        range 4 255
        help
          Listeners made by C code (devices, VM, power manager), inline or
          queued.

    config SYS_EVENT_MAX_RULES
        int "Rules"
        default 16
        range 1 254
        help
          Remote "event -> action" listeners, a table of their own so rules
          never take a device's slot.

    config SYS_EVENT_QUEUE_LEN
        int "Queue (events)"
        default 16
        range 4 128
        help
          Events waiting for the event task (queued listeners, rules, events
          from ISRs). A full queue drops the event.

    config SYS_EVENT_MAX_HOPS
        int "Republish depth"
        default 4
        range 1 16
        help
          An event published because of another (SYS_EVENT_CAUSED_BY) at this
          depth is dropped with ERR_EVENT_LOOP.

    config SYS_EVENT_TASK_PRIO
        int "Task priority"
        default 6
        range 1 24
        help
          Above the router work task (5), below the urgent task (15).

    config SYS_EVENT_TASK_STACK
        int "Task stack (bytes)"
        default 4096
        range 3072 32768
        help
          Runs queued listeners: device ON_EVENT ops (I2C), rules.

endmenu
```

## _SOFTWARE/components/sys/sys_log/Kconfig
```kconfig
menu "sys_log"

    config SYS_LOG_LINE_MAX
        int "Captured log line (bytes)"
        default 160
        range 32 480
        help
          Log lines sent to the logs connector are cut to this. Formatted on
          the stack of the task that logs.

endmenu
```

## _SOFTWARE/components/sys/sys_power_manager/Kconfig
```kconfig
menu "sys_power_manager"

    config SYS_POWER_MANAGER_TASK_STACK
        int "Task stack (bytes)"
        default 4096
        range 2048 16384

    config SYS_POWER_MANAGER_TASK_PRIO
        int "Task priority"
        default 4
        range 1 24

    config SYS_POWER_MANAGER_PERIOD_MS
        int "Period (ms)"
        default 1000
        range 100 10000
        help
          How often the manager measures the input, detects the source and
          updates the budget and the battery estimate. A settings change wakes
          it at once.

    config SYS_POWER_MANAGER_MAX_CONSUMERS
        int "Budgeted rails"
        default 4
        range 1 16

    config SYS_POWER_MANAGER_BUDGET_STEP_MW
        int "Budget change threshold (mW)"
        default 250
        range 0 10000
        help
          The automatic rail caps are recomputed when the budget changes by at
          least this much, so noise on the input voltage doesn't reprogram the
          regulators every period.

    config SYS_POWER_MANAGER_INPUT_WARNING_PCT
        int "Input current warning (% of the limit)"
        default 90
        range 10 99
        help
          The input monitor's warning alert sits at this share of the limit's
          current; the critical alert at the limit itself.

    config SYS_POWER_MANAGER_BATTERY_HYSTERESIS_PCT
        int "Battery threshold hysteresis (%)"
        default 3
        range 1 20
        help
          BATTERY_LOW / _CRITICAL are raised once and re-armed when the charge
          rises this far above the threshold.

endmenu
```

## _SOFTWARE/components/sys/sys_project/Kconfig
```kconfig
menu "sys_project"

    config SYS_PROJECT_MAX_BYTES
        int "Largest project stream (bytes)"
        default 65536
        range 1024 262144
        help
          Largest stream a project save accepts (all sections, with their u16
          frame lengths). The stream is stored twice while a save runs (the
          new bank next to the stored one), so keep twice this below the
          project partition (partitions.csv, 512 KB shared with the actions).

    config SYS_PROJECT_MAX_SECTIONS
        int "Sections with their own ID"
        default 40
        range 1 255
        help
          Settings, device and user records one project may carry next to its
          program (the log and power settings are 5, every device one).

    config SYS_PROJECT_MAX_CHUNKS
        int "Program chunks"
        default 32
        range 1 255
        help
          The program is cut into records of CONFIG_SYS_ACTIONS_MAX_BYTES at
          the most (whole frames only); this many of them. Together with the
          record size it bounds the program (32 x 4 KB = 128 KB).

endmenu
```

## _SOFTWARE/components/sys/sys_uart/Kconfig
```kconfig
menu "sys_uart"

    config SYS_UART_TASK_PRIO
        int "RX task priority"
        default 5
        range 1 24
        help
          Priority of the task that reads the console UART (and USB-Serial-JTAG)
          and turns "#R:" hex lines into router frames.

    config SYS_UART_TASK_STACK
        int "RX task stack (bytes)"
        default 3072
        range 2048 16384
        help
          The line and frame buffers are static, not on this stack.

    config SYS_UART_DRIVER_RX_BUF
        int "Driver RX buffer (bytes)"
        default 1024
        range 256 8192
        help
          RX buffer of the UART (and USB-Serial-JTAG) driver installed on the
          console. Must be larger than the UART hardware FIFO (128 bytes).

endmenu
```

## _SOFTWARE/components/sys_errors/Kconfig
```kconfig
menu "System Errors Options"
    config SYS_ERRORS_BUF_SIZE
        int "Error Pool Buffer Size (bytes)"
        default 1024
        range 128 8192
        help
          Total size of the bounded error node allocator's backing buffer.

    config SYS_ERRORS_BLOCK_SIZE
        int "Error Pool Block Size (bytes)"
        default 32
        range 8 256
        help
          Allocation granularity of the error node pool. SYS_ERRORS_BUF_SIZE
          must be evenly divisible by this value.

    config SYS_ERRORS_LOG_LINE_MAX
        int "Log Line Stack Buffer Size (bytes)"
        default 512
        range 64 4096
        help
          Stack buffer size the log hook renders one line into.

    config SYS_ERRORS_MAX_DOMAIN_HOOKS
        int "Maximum Domain Fault Hooks"
        default 8
        range 1 32
        help
          Slots for SE_register_domain_hook() (one per module domain that
          has containment logic for its own critical errors).

    config SYS_ERRORS_LOG_QUEUE_LEN
        int "Error Log Queue Length (chains)"
        default 4
        range 1 16
        help
          Error chains waiting for the log task. A waiting chain keeps its
          pool nodes, so keep this well under the pool's 32 blocks. When the
          queue is full a chain is dropped and counted; the count is logged.

    config SYS_ERRORS_REPEAT_WINDOW_MS
        int "Repeated Error Window (ms)"
        default 2000
        range 0 60000
        help
          A chain identical to one logged less than this long ago (same tag
          and owner at every node) is counted instead of logged and sent.
          When the window ends, one line reports how many repeats were
          dropped. Responses still run for every occurrence. 0 disables it.

    config SYS_ERRORS_REPEAT_SLOTS
        int "Repeated Error Slots"
        default 4
        range 1 16
        help
          How many different recent chains are tracked for repeat
          suppression.

    config SYS_ERRORS_LOG_TASK_STACK_SIZE
        int "Error Log Task Stack Size (bytes)"
        default 4096
        range 2048 16384
        help
          The log task formats chains (two SYS_ERRORS_LOG_LINE_MAX buffers)
          and encodes packets (SYS_ERRORS_PACKET_MAX) on its own stack, so
          tasks that raise errors don't need that stack.

    config SYS_ERRORS_LOG_TASK_PRIO
        int "Error Log Task Priority"
        default 2
        range 1 24
        help
          Low on purpose: responses to errors run synchronously in the task
          that raised them; only logging and telemetry wait for this task.

    config SYS_ERRORS_PACKET_MAX
        int "Error Packet Buffer Size (bytes)"
        default 512
        range 64 4096
        help
          Compile-time ceiling for binary error packet buffer.
endmenu
```
