## _SOFTWARE/runit-esp-rework/components/sys/sys_session/Kconfig
```kconfig
menu "sys_session"

    config SYS_SESSION_MAX
        int "Sessions"
        default 4
        range 1 16
        help
          Providers attached to a peer: a slave's master, or the master's
          slaves and clients.

    #@limit @alias Calls to other boards
    config SYS_SESSION_CALLS
        int "Calls in flight"
        default 16
        range 1 64
        help
          The board's own requests to other boards waiting for an answer
          (sys_session_call); a call to this board takes none. Every call to
          another board is answered, so each write of a remote device in
          flight takes one. A slot is about 52 B.

    #@limit @alias Call timeout @unit ms
    config SYS_SESSION_CALL_TIMEOUT_MS
        int "Call timeout (ms)"
        default 1000
        range 50 10000
        help
          A call without an answer this long ends with ERR_SESSION_TIMEOUT,
          unless the caller gives its own. Longer than a radio's tail, so a
          slow answer is not taken for a lost one.

    config SYS_SESSION_BOARD_ID_DEFAULT
        int "Board id until the app sets one"
        default 0
        range 0 239
        help
          The board's id when none is kept in NVS (ID). Two boards of one
          project need different ids: the app sets them with ID.

    config SYS_SESSION_PEER_LISTENERS
        int "Peer listeners"
        default 5
        range 1 8
        help
          sys_session_on_gone and sys_session_on_reached slots, each: the
          dead-man and the time (sys_system), the streams, the watches, the
          remote devices.

    config SYS_SESSION_PUSH_LISTENERS
        int "Push listeners"
        default 2
        range 1 4
        help
          sys_session_on_push slots: who takes the PUSH frames
          of a session channel.

    #@limit @alias Session timeout @unit ms
    config SYS_SESSION_TIMEOUT_MS
        int "Session timeout (ms)"
        default 3000
        range 150 60000
        help
          A slave's session with nothing received for this long ends: its
          calls fail, its peers are gone, the hello starts again. The hello
          tells the peer, which sends at least every third of it. The master's
          and the clients' sessions take the dead-man's time instead
          (sys_session_set_timeout).

endmenu
```

## _SOFTWARE/runit-esp-rework/components/sys/sys_system/Kconfig
```kconfig
menu "sys_system"

    config SYS_SYSTEM_DEADMAN_DEFAULT_MS
        int "Dead-man timeout at boot (ms, 0 = off)"
        default 0
        range 0 60000
        help
          0, or the dead-man's time (150..60000) of the sessions app/runit
          attaches at boot (the console and the runIT BLE pair), with the
          safety flag: their end enters the safe state. Changed per session at runtime with the sys
          DEADMAN command; not stored.

    config SYS_SYSTEM_TIME_PERIOD_S
        int "Time broadcast period (s)"
        default 60
        range 5 3600
        help
          A board sends its time on every open session this often (and when a
          client sets it, and when a peer is reached), so the clocks of the
          boards that talk follow it.

endmenu
```

## _SOFTWARE/runit-esp-rework/components/sys/sys_watch/Kconfig
```kconfig
menu "sys_watch"

    #@limit Server watches
    config SYS_WATCH_MAX
        int "Maximum watches on this board"
        default 24
        range 1 64
        help
          Reads that peers added on this board (ADD), of every owner.

    #@limit Client watches
    config SYS_WATCH_CLIENT_MAX
        int "Maximum remote reads cached on this board"
        default 24
        range 1 64
        help
          Cached remote reads kept by the watch client (sys_watch_read).

    config SYS_WATCH_READ_PERIOD_MS
        int "Cached read poll period (ms)"
        default 100
        range 10 60000
        help
          ON_CHANGE poll period sent in ADD for sys_watch_read(); max_silence
          is twice this and a cached copy turns ERR_WATCH_STALE after three
          times this without a fresh entry.

    config SYS_WATCH_IDLE_MIN_MS
        int "Minimum idle time before removing a cached read watch (ms)"
        default 1000
        range 100 60000
        help
          A cached read not read for 10 x stale limit (and at least this
          long) is removed from its board with WATCH REMOVE.

endmenu
```

## _SOFTWARE/runit-esp-rework/main/Kconfig.projbuild
```kconfig
menu "Board"

    config BOARD_UART_LINK
        bool "Board-to-board UART link"
        default y
        help
          Create the board's link UART (ESP32S3_UART, SYS_DEVICE_CREATE_SYSTEM) to connect to
          another runIT board's console UART and bridge it as a FRAMED provider via provider_uart.

    config BOARD_UART_LINK_PORT
        int "Link UART port"
        depends on BOARD_UART_LINK
        default 1
        range 1 2
        help
          Hardware UART controller for the board-to-board link (distinct from console UART0).

    config BOARD_UART_LINK_TX_PIN
        int "Link TX pin (GPIO)"
        depends on BOARD_UART_LINK
        default 18
        range 0 48
        help
          Joined to the peer board's U0RXD (GPIO 44 on ESP32-S3).

    config BOARD_UART_LINK_RX_PIN
        int "Link RX pin (GPIO)"
        depends on BOARD_UART_LINK
        default 17
        range 0 48
        help
          Joined to the peer board's U0TXD (GPIO 43 on ESP32-S3).

    config BOARD_UART_LINK_RTS_PIN
        int "Link RTS pin (GPIO, -1 = none)"
        depends on BOARD_UART_LINK
        default -1
        range -1 48
        help
          Optional hardware flow-control RTS pin on ESP32-S3 GPIO (-1 = unused).

    config BOARD_UART_LINK_CTS_PIN
        int "Link CTS pin (GPIO, -1 = none)"
        depends on BOARD_UART_LINK
        default -1
        range -1 48
        help
          Optional hardware flow-control CTS pin on ESP32-S3 GPIO (-1 = unused).

endmenu
```

## _SOFTWARE/runit-esp/components/core/board_id/Kconfig
```kconfig
menu "board_id"

    config BOARD_ID_DEFAULT
        int "Board id until the app sets one"
        default 0
        range 0 239
        help
          The board's id when the store keeps none (the session's ID): 0 is
          none given. Two boards of one project need different ids: the app
          sets them with ID.

endmenu
```

## _SOFTWARE/runit-esp/components/core/data_matrix/Kconfig
```kconfig
menu "data_matrix"

    config DATA_MATRIX_PORTS
        int "Ports"
        default 32
        range 2 254
        help
          The ports the switch can hold: the modules', the providers' and
          the sessions'. One place is 16 bytes on the board.

    config DATA_MATRIX_TARGETS
        int "Targets of one port"
        default 8
        range 1 16
        help
          The ports one port's output can go to. A send copies them onto the
          sender's stack (a pointer each).

endmenu
```

## _SOFTWARE/runit-esp/components/core/router/Kconfig
```kconfig
menu "router"

    config ROUTER_MAX_KEYS
        int "Root keys"
        default 24
        range 2 64
        help
          Root table slots (router_register).

endmenu
```

## _SOFTWARE/runit-esp/components/core/router_queue/Kconfig
```kconfig
menu "router_queue"

    config ROUTER_WORK_QUEUE_SIZE
        int "Work queue (bytes)"
        default 4096
        range 1024 32768
        help
          Ring buffer of normal commands waiting for the work task: each takes
          its request, a 16-byte header (answer callback, its ctx, origin) and
          the ring's own header. Multiple of 4.

    config ROUTER_URGENT_QUEUE_SIZE
        int "Urgent queue (bytes)"
        default 1024
        range 256 8192
        help
          Ring buffer of commands flagged urgent. Multiple of 4.

    config ROUTER_WORK_TASK_PRIO
        int "Work task priority"
        default 5
        range 1 24

    config ROUTER_WORK_TASK_STACK
        int "Work task stack (bytes)"
        default 6144
        range 3072 32768
        help
          Runs the module routers of normal commands and their answer
          callbacks (the session's framer).

    config ROUTER_URGENT_TASK_PRIO
        int "Urgent task priority"
        default 15
        range 1 24
        help
          Above every task that may run a long command, so an urgent one
          (stop) never waits behind it.

    config ROUTER_URGENT_TASK_STACK
        int "Urgent task stack (bytes)"
        default 6144
        range 3072 32768
        help
          Runs urgent commands and router_run_urgent (the safe-state
          handler on a dead-man).

    #@limit @alias Calls to other boards
    config ROUTER_CALLS
        int "Calls in flight"
        default 16
        range 1 64
        help
          This board's calls out of the router's port waiting for an answer
          (router_request); a call to this board takes none. Every call out is
          answered, so each write of a remote device in flight takes one. A
          slot is about 52 B.

    #@limit @alias Call timeout @unit ms
    config ROUTER_CALL_TIMEOUT_MS
        int "Call timeout (ms)"
        default 1000
        range 50 10000
        help
          A call without an answer this long ends with
          ERR_ROUTER_CALL_TIMEOUT, unless the caller gives its own. Longer than
          a radio's tail, so a slow answer is not taken for a lost one.

endmenu
```

## _SOFTWARE/runit-esp/components/core/timer/Kconfig
```kconfig
menu "board_timer"

    config BOARD_TIMER_TASK_PRIO
        int "Task priority"
        default 7
        range 1 24
        help
          Runs every board timer's callback (a motor's ramp, a poll, a
          timeout). Above the event task (6), so a step is not held up by
          event listeners; below the urgent task (15).

    config BOARD_TIMER_TASK_STACK
        int "Task stack (bytes)"
        default 4096
        range 3072 32768
        help
          The callbacks run on it: a driver's step with its bus calls (I2C)
          and the device calls it makes.

endmenu
```

## _SOFTWARE/runit-esp/components/devices/chips/device_spi_lcd/Kconfig
```kconfig
menu "device_spi_lcd"

    config DEVICE_SPI_LCD_FLUSH_MAX
        int "Largest FLUSH (bytes)"
        default 12800
        range 64 65536
        help
          The largest FLUSH a display takes (GEOMETRY's flush_max): one window of
          pixels sent in one SPI transaction. At most the bus's max_transfer.
          12800 is 20 lines of 320 pixels in RGB565.

endmenu
```

## _SOFTWARE/runit-esp/components/devices/soc/device_esp32_spi/Kconfig
```kconfig
menu "device_esp32_spi"

    config DEVICE_ESP32_SPI_SLOTS
        int "Chips per bus"
        default 4
        range 1 6
        help
          How many chips one SPI bus device holds at once (ATTACH beyond it is
          ERR_SPI_NO_SLOT). ESP-IDF takes at most 6 devices per controller.

    config DEVICE_ESP32_SPI_QUEUE_MAX
        int "Queued transfers per chip"
        default 4
        range 1 16
        help
          The largest queue_depth an ATTACH may ask for: the transactions a
          chip may have queued at once (QUEUE).

    config DEVICE_ESP32_SPI_BOUNCE_BYTES
        int "Bounce buffer (bytes)"
        default 64
        range 16 4096
        help
          A blocking transfer that writes, then reads, in one CS goes through
          this buffer: its tx and rx together are at most this long. A bus
          has two of them (sent and received bytes), 2x this in RAM.

endmenu
```

## _SOFTWARE/runit-esp/components/devices/soc/device_esp32s3_uart/Kconfig
```kconfig
menu "device_esp32s3_uart"

    config ESP32S3_UART_ISR_RX_BUF
        int "ESP-IDF UART RX driver buffer size (bytes)"
        default 4096
        range 256 16384
        help
          Per-port RX ring buffer allocated by esp_driver_uart (> 128 B HW FIFO)
          so flash writes / NVS pauses do not overflow RX.

    config ESP32S3_UART_EVT_QUEUE_LEN
        int "ESP-IDF UART event queue length"
        default 16
        range 8 64
        help
          Queue entries allocated by esp_driver_uart for UART_DATA and error
          interrupt notifications.

    config ESP32S3_UART_TX_QUEUE
        int "TX queue per port (bytes)"
        default 4096
        range 1088 16384
        help
          Must be a multiple of 4 and hold at least two max frames
          (2 * 524 = 1048 B). SPARE sends fail with ERR_UART_BUSY once past half.

    config ESP32S3_UART_RX_QUEUE
        int "RECEIVE queue per port (bytes)"
        default 2048
        range 544 16384
        help
          Messages kept for RECEIVE / TRANSACT while the port has no reader
          (when full, the oldest goes). A multiple of 4, at least one
          512-byte message (520 B).

    config ESP32S3_UART_RX_TASK_STACK
        int "RX task stack size (bytes)"
        default 4096
        range 2048 16384

    config ESP32S3_UART_TX_TASK_STACK
        int "TX task stack size (bytes)"
        default 3072
        range 2048 16384

    config ESP32S3_UART_RX_TASK_PRIO
        int "RX task priority"
        default 10
        range 1 24

    config ESP32S3_UART_TX_TASK_PRIO
        int "TX task priority"
        default 5
        range 1 24

endmenu
```

## _SOFTWARE/runit-esp/components/providers/provider_uart/Kconfig
```kconfig
menu "provider_uart"

    config PROVIDER_UART_SEND_WAIT_MS
        int "Queued send wait (ms)"
        default 1000
        range 10 1000
        help
          Wait passed to OP_SEND_FRAME when CMD_SEND_NOWAIT is clear (up to SYS_UART_WAIT_MAX_MS).

endmenu
```
