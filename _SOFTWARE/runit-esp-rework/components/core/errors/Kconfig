## _SOFTWARE/runit-esp-rework/components/core/errors/Kconfig
```kconfig
menu "Errors"

    config ERRORS_INFO
        bool "Record where errors are created"
        default y
        help
          Store the place an error was created: the source file name
          (__FILE_NAME__, without the path), the line and the function. One
          record per call site, in flash; the node points to it. Costs one
          string per source file and per function that creates errors, in
          flash. When off, error nodes have no `info` field at all.

    config ERRORS_POOL_BLOCKS
        int "Error pool: number of blocks"
        default 32
        range 4 255
        help
          How many error nodes can exist at once (one node = one block).
          RAM used = ERRORS_POOL_BLOCKS * ERRORS_POOL_BLOCK_SIZE.

    config ERRORS_POOL_BLOCK_SIZE
        int "Error pool: block size (bytes)"
        default 32
        range 16 128
        help
          Size of one block = node header (12 B with info, 8 B without) +
          largest payload. Must be a multiple of 4.

    config ERRORS_LOG_LINE_LEN
        int "Error log: line buffer size (bytes)"
        default 256
        range 64 512
        help
          Size of the stack buffer err_log() formats one chain node into.
          Longer lines are cut.

    config ERRORS_RECORD_REQ_MAX
        int "Request bytes kept in an error record"
        default 32
        range 0 127
        help
          How much of the failing request (keys + payload) an error record
          repeats. Longer requests are cut and marked.

    config ERRORS_MAX_MODULES
        int "Maximum error modules"
        default 32
        range 1 255
        help
          How many modules can register an error tag table
          (ERR_MODULE_DEFINE). One pointer of RAM per slot.

endmenu
```

## _SOFTWARE/runit-esp-rework/components/devices/device_esp32s3_gpio/Kconfig
```kconfig
menu "device_esp32s3_gpio"

    config ESP32S3_GPIO_PWM_DEFAULT_FREQ_HZ
        int "PWM frequency before one is set (Hz)"
        range 5 5000000
        default 1000
        help
          The frequency a PWM pin starts at when its duty is written before
          any frequency. Pins share LEDC timers by frequency, so the pins left
          at this default use one timer between them.

    config ESP32S3_GPIO_PWM_TIMER_MASK
        hex "LEDC timers PWM pins may use (bit per timer)"
        range 0x1 0xF
        default 0xF
        help
          Bit n set: LEDC timer n is for PWM pins (ESP32-S3: timers 0-3).
          Clear the bits of the timers another LEDC user needs (a buzzer, an
          LCD backlight, a camera clock). Each timer runs one PWM frequency,
          so this is also the number of frequencies at once. Other LEDC users
          must use the APB clock too: on the ESP32-S3 every LEDC timer shares
          one clock source.

    config ESP32S3_GPIO_PWM_CHANNEL_MASK
        hex "LEDC channels PWM pins may use (bit per channel)"
        range 0x1 0xFF
        default 0xFF
        help
          Bit n set: LEDC channel n is for PWM pins (ESP32-S3: channels 0-7).
          One channel per PWM pin, so this is also the number of pins that
          run PWM at once. Clear the bits of the channels another LEDC user
          needs.

    config ESP32S3_GPIO_DEBOUNCE_MS
        int "Debounce time of pin interrupts (ms)"
        range 1 1000
        default 50
        help
          A pin armed by INTR with debounce = 1 ignores the edges that come
          sooner than this after the last one it published. A pin armed with
          debounce = 0 (a chip's alert line) publishes every edge.

    config ESP32S3_GPIO_ADC_TASK_STACK
        int "Stack of the ADC task (bytes)"
        range 2048 16384
        default 4096
        help
          The task that reads the conversion of the pins in ADC mode, filters
          it and raises their thresholds. Its frame buffer (256 B) is on this
          stack.

    config ESP32S3_GPIO_ADC_TASK_PRIO
        int "Priority of the ADC task"
        range 1 24
        default 5
        help
          Below the tasks that run commands and events: the readings are
          filtered, so a late frame costs nothing but its delay.

endmenu
```

## _SOFTWARE/runit-esp-rework/components/devices/device_esp32s3_i2c/Kconfig
```kconfig
menu "device_esp32s3_i2c"

    config ESP32S3_I2C_XFER_TIMEOUT_MS
        int "Transfer timeout (ms)"
        default 50
        range 5 5000
        help
          Timeout of one transfer (write, read, write-read), including the wait
          for the bus lock when another task is using the bus.

    config ESP32S3_I2C_PROBE_TIMEOUT_MS
        int "Probe timeout (ms)"
        default 50
        range 5 5000
        help
          Timeout of the address probe done by ATTACH, PROBE and SCAN.

    config ESP32S3_I2C_GLITCH_IGNORE_CNT
        int "Glitch filter (I2C module clock cycles)"
        default 7
        range 0 7
        help
          Pulses on SDA/SCL shorter than this are ignored. Applies to every
          bus of this type.

endmenu
```

## _SOFTWARE/runit-esp-rework/components/devices/soc/device_esp32s3_uart/Kconfig
```kconfig
menu "device_esp32s3_uart"

    config ESP32S3_UART_MAX_PORTS
        int "Maximum concurrent UART port devices (static slots)"
        default 2
        range 1 3
        help
          Number of static port engine slots (tasks, TX/RX ring buffers, line
          buffers). ESP32-S3 has 3 UART controllers (0..2); UART0 is normally
          the console, leaving UART1 and UART2 (2 slots). Set to 3 only if
          all 3 controllers are used as devices.

    config ESP32S3_UART_ISR_RX_BUF
        int "ESP-IDF UART RX driver buffer size (bytes)"
        default 4096
        range 256 16384
        help
          Per-port RX ring buffer allocated by esp_driver_uart (> 128 B HW FIFO)
          so flash writes / NVS pauses do not overflow RX.

    config ESP32S3_UART_EVT_QUEUE_LEN
        int "ESP-IDF UART event queue length"
        default 16
        range 8 64
        help
          Queue entries allocated by esp_driver_uart for UART_DATA and error
          interrupt notifications.

    config ESP32S3_UART_TX_QUEUE
        int "Static TX ring buffer size per port (bytes)"
        default 4096
        range 1088 16384
        help
          Must be a multiple of 4 and hold at least two max frames
          (2 * 524 = 1048 B). SPARE sends fail with ERR_UART_BUSY once past half.

    config ESP32S3_UART_RX_QUEUE
        int "Static RX message queue size per port (bytes)"
        default 2048
        range 544 16384
        help
          Messages queued for OP_RECEIVE / OP_TRANSACT when neither SUBSCRIBE
          nor RX_HOOK is active. Must be a multiple of 4 and hold at least one
          512-byte message (520 B).

    config ESP32S3_UART_RX_TASK_STACK
        int "RX task stack size (bytes)"
        default 4096
        range 2048 16384

    config ESP32S3_UART_TX_TASK_STACK
        int "TX task stack size (bytes)"
        default 3072
        range 2048 16384

    config ESP32S3_UART_RX_TASK_PRIO
        int "RX task priority"
        default 10
        range 1 24

    config ESP32S3_UART_TX_TASK_PRIO
        int "TX task priority"
        default 5
        range 1 24

    config ESP32S3_UART_OVERFLOW_THROTTLE_MS
        int "Minimum interval between UART_EV_OVERFLOW events (ms)"
        default 1000
        range 100 60000

endmenu
```

## _SOFTWARE/runit-esp-rework/components/providers/provider_ble/Kconfig
```kconfig
menu "provider_ble"

    config PROVIDER_BLE_SEND_WAIT_MS
        int "Send wait (ms)"
        default 100
        range 1 5000
        help
          How long a packet without CMD_SEND_NOWAIT waits for room in its characteristic's TX buffer; then, or at
          once with NOWAIT, it is lost (ERR_BLE_TX_FULL).

    config PROVIDER_BLE_TX_ITEMS
        int "TX buffer (frames)"
        default 4
        range 1 16
        help
          How many frames of CMD_FRAME_MAX the TX buffer of a characteristic the provider makes holds
          (SYS_BLE_TX_BYTES).

endmenu
```

## _SOFTWARE/runit-esp-rework/components/providers/provider_console/Kconfig
```kconfig
menu "provider_console"

    config PROVIDER_CONSOLE_RX_TASK_PRIO
        int "RX task priority"
        default 5
        range 1 24
        help
          Priority of the task that reads the console UART (and USB-Serial-JTAG)
          and hands each frame (COBS, CRC16 checked) to the provider's user.

    config PROVIDER_CONSOLE_RX_TASK_STACK
        int "RX task stack (bytes)"
        default 4096
        range 2048 16384
        help
          The frame buffers are static, not on this stack. The session's
          handling of a hello or a lost child runs on it.

    config PROVIDER_CONSOLE_DRIVER_RX_BUF
        int "Driver RX buffer (bytes)"
        default 1024
        range 256 8192
        help
          RX buffer of the UART (and USB-Serial-JTAG) driver installed on the
          console. Must be larger than the UART hardware FIFO (128 bytes).

    config PROVIDER_CONSOLE_TX_QUEUE
        int "TX queue (bytes)"
        default 8192
        range 1024 32768
        help
          Frames waiting for the TX task (answers, PUSH frames); each takes
          its length and CRC (2) rounded to 4, + 8 bytes. Urgent frames have a queue of
          their own, written first. Larger than the stream queue
          (CONFIG_DATA_MATRIX_QUEUE_SIZE), so a burst of PUSH frames
          fills that one first and its producer is refused (and resends), not
          lost here unseen. Multiple of 4.

    config PROVIDER_CONSOLE_TX_TASK_PRIO
        int "TX task priority"
        default 2
        range 1 24
        help
          The task that encodes the queued frames and writes them. Low: the
          console is slow, and nothing waits for it but the queue.

    config PROVIDER_CONSOLE_TX_TASK_STACK
        int "TX task stack (bytes)"
        default 3072
        range 2048 16384

    config PROVIDER_CONSOLE_SEND_WAIT_MS
        int "Send wait (ms)"
        default 1000
        range 10 10000
        help
          How long a send without NOWAIT (an answer) waits for room in the TX
          queue, then ERR_PROV_BUSY; a NOWAIT send (a PUSH frame) is
          ERR_PROV_BUSY at once. Also how long a frame waits for the
          USB-Serial-JTAG host.

endmenu
```

## _SOFTWARE/runit-esp-rework/components/sys/data_matrix/Kconfig
```kconfig
menu "data_matrix"

    config DATA_MATRIX_PORTS
        int "Stream ports"
        default 32
        range 2 254
        help
          The ports the switch can hold: the modules' streams and the
          providers. One place is 12 bytes on the board.

    config DATA_MATRIX_TARGETS
        int "Targets of one port"
        default 4
        range 1 16
        help
          The ports one port's output can go to. A send copies them onto the
          sender's stack (a pointer each).

endmenu
```

## _SOFTWARE/runit-esp-rework/components/sys/sys_data_provider/Kconfig
```kconfig
menu "Providers (sys_data_provider)"

    config SYS_DATA_PROVIDER_MAX
        int "Maximum providers registered on the board"
        default 8
        range 1 32
        help
            Fixed table of provider slots; static and CREATEd providers share it.

    config SYS_DATA_PROVIDER_SIZE
        int "Largest driver struct of a provider, in bytes"
        default 64
        range 16 1024
        help
            Every provider slot holds its driver's struct (sys_data_provider_t first), never freed:
            SYS_DATA_PROVIDER_MAX slots of this size. A larger driver struct fails to build.

    config SYS_DATA_PROVIDER_TYPES
        int "Maximum provider driver types"
        default 8
        range 1 32
        help
            Self-registered provider driver types (SYS_DATA_PROVIDER_TYPE_DEFINE).

endmenu
```

## _SOFTWARE/runit-esp-rework/components/sys/sys_event/Kconfig
```kconfig
menu "sys_event"

    config SYS_EVENT_MAX_SUBS
        int "Subscriptions (C)"
        default 32
        range 4 255
        help
          Listeners made by C code: inline ones (a device's ON_EVENT) and
          queued ones (the VM, the power manager; the event task).

    config SYS_EVENT_QUEUE_BYTES
        int "Queue (bytes)"
        default 1024
        range 256 16384
        help
          Room of the ring buffer for events waiting for the event task (for
          the queued listeners, events from ISRs and deferred publishes). An
          event takes the buffer's 8 B, its own 4 B, its 20 B header and
          its payload. A multiple of 4. A full buffer drops the event.

    config SYS_EVENT_DATA_MAX
        int "Largest payload (bytes)"
        default 64
        range 8 256
        help
          The most bytes of an event's payload (a text of a screen's object).
          A larger payload in an events table fails to compile.

    config SYS_EVENT_TASK_PRIO
        int "Task priority"
        default 6
        range 1 24
        help
          Above the router work task (5), below the urgent task (15).

    config SYS_EVENT_TASK_STACK
        int "Task stack (bytes)"
        default 4096
        range 3072 32768
        help
          Runs the queued listeners (the VM, the power manager) and every
          listener of an ISR or deferred event: device ON_EVENT ops (I2C).

endmenu
```

## _SOFTWARE/runit-esp-rework/components/sys/sys_log/Kconfig
```kconfig
menu "sys_log"

    config SYS_LOG_LINE_MAX
        int "Max log line (bytes)"
        default 160
        range 64 512
        help
          Longest cleaned ESP_LOG line queued to SYS_STREAM_LOGS; longer lines
          are truncated before sending.

    config SYS_LOG_ERRORS_KEPT
        int "Error history capacity"
        default 16
        range 1 64
        help
          How many recent error records (up to SYS_LOG_RECORD_MAX bytes each)
          are kept in memory for LOG_OP_ERRORS; older ones are overwritten.

endmenu
```

## _SOFTWARE/runit-esp-rework/components/sys/sys_remote/Kconfig
```kconfig
menu "sys_remote"

    #@limit @alias Remote subscriptions
    config SYS_REMOTE_SUBSCRIPTIONS
        int "Subscriptions to this board's devices"
        default 16
        range 1 64
        help
          Peers subscribed to a device of this board (SUBSCRIBE): each gets the
          device's events and errors. Another board's remote device takes one.

    config SYS_REMOTE_QUEUE_SIZE
        int "Queue (bytes)"
        default 1024
        range 256 8192
        help
          The events and errors on their way: out to the subscribers of this
          board's devices, and in from the boards of the remote devices. A
          multiple of 4.

    config SYS_REMOTE_TASK_PRIO
        int "Task priority"
        default 4
        range 1 20

    config SYS_REMOTE_TASK_STACK
        int "Task stack (bytes)"
        default 4096
        range 2048 16384

endmenu
```
