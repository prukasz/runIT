## _SOFTWARE/runit-esp/components/sys/bus/sys_ble/Kconfig
```kconfig
menu "sys_ble"

    config SYS_BLE_DEVICE_NAME
        string "Device name"
        default "runit"
        help
          The GAP name the board advertises.

    config SYS_BLE_TASK_PRIO
        int "BLE task priority"
        default 5
        range 1 24
        help
          The task that sends the queued items and applies the staged GATT changes.

    config SYS_BLE_TASK_STACK
        int "BLE task stack (bytes)"
        default 4096
        range 2048 32768

    config SYS_BLE_APPLY_DELAY_MS
        int "Apply delay with a client connected (ms)"
        default 200
        range 0 5000
        help
          APPLY with a client connected waits this long, so the command that asked for it is answered before the
          Service Changed indication.

endmenu
```

## _SOFTWARE/runit-esp/components/sys/sys_device/Kconfig
```kconfig
menu "sys_device"

    config SYS_DEVICE_TYPES
        int "Device types"
        default 32
        range 1 64
        help
          Driver types this firmware registers (SYS_DEVICE_TYPE_DEFINE).

    config SYS_DEVICE_INTERCEPTORS
        int "Interceptors"
        default 2
        range 1 8
        help
          Contracts that can have an interceptor (sys_device_set_interceptor):
          a module that sees every call of the contract's ops before the
          device does (the power manager on POWER_VREG).

    config SYS_DEVICE_LOCK_TIMEOUT_MS
        int "Wait for a device's lock (ms)"
        default 500
        range 100 60000
        help
          The longest a call waits for the lock of its device before it fails
          with ERR_DEV_BUSY (the op that holds the lock is in the error), so
          one device that hangs does not hold up the tasks that call it for
          good (the timers' task, the event task, a sweep). Longer than the
          slowest op of a device that runs under its lock (50 ms per I2C
          transfer; long ops like I2C SCAN use SYS_DEVICE_OP_NOLOCK).

    config SYS_DEVICE_EVENT_HOLD_BYTES
        int "Events held during a call (bytes)"
        default 256
        range 32 2048
        help
          Room for the events published inside device ops, kept until the
          task's outermost sys_device_call is over and then delivered to the
          inline listeners. On the stack of the task that makes that call,
          only while it runs. An event takes 4 B, its 20 B header and its
          payload, padded to 4 B; one that does not fit goes to the event
          task. A multiple of 4.

endmenu
```

## _SOFTWARE/runit-esp/components/sys/sys_device_policy/Kconfig
```kconfig
menu "sys_device_policy"

    config SYS_DEVICE_POLICY_QUEUE_BYTES
        int "Queue (bytes)"
        default 1024
        range 256 8192
        help
          Room of the ring buffer for the reported errors that wait for the
          policy's task, each as a record (the buffer's 8 B and the record).
          Only an error that needs a response is queued. A full buffer fails
          the report with ERR_DEV_FAULT_RESPONSE (stage QUEUE). A multiple
          of 4, at least twice the largest record.

    config SYS_DEVICE_POLICY_TASK_PRIO
        int "Task priority"
        default 14
        range 1 24
        help
          The task that stops the VM and suspends every device on a critical
          error: above the event task (6) and the router work task (5), so
          the safe state is not kept waiting by them; below the urgent task
          (15).

    config SYS_DEVICE_POLICY_TASK_STACK
        int "Task stack (bytes)"
        default 4096
        range 3072 32768
        help
          Runs the responses: the sweep of every device (their suspend()
          hooks, I2C), a device's SUSPEND or RESET, the action runner.

endmenu
```

## _SOFTWARE/runit-esp/components/sys/sys_event/Kconfig
```kconfig
menu "sys_event"

    config SYS_EVENT_MAX_SUBS
        int "Subscriptions (C)"
        default 32
        range 4 255
        help
          Listeners made by C code: inline ones (a device's ON_EVENT) and
          queued ones (the power manager, sys_device_remote; a lane's task).

    config SYS_EVENT_DATA_MAX
        int "Largest payload (bytes)"
        default 64
        range 8 256
        help
          The most bytes of an event's payload (a text of a screen's object).
          A larger payload in an events table fails to compile.

    menu "Lane SYS"

        config SYS_EVENT_SYS_QUEUE_BYTES
            int "Queue (bytes)"
            default 1024
            range 256 16384
            help
              Room of the lane's ring buffer for its events waiting for its
              task (for its queued listeners, its events from ISRs and its
              deferred publishes). An event takes the buffer's 8 B, its own
              4 B, its 20 B header and its payload. A multiple of 4. A full
              buffer drops the event.

        config SYS_EVENT_SYS_TASK_PRIO
            int "Task priority"
            default 7
            range 1 24
            help
              Above the device lane (6), so a flood of device events can't hold
              the system's back; below the urgent task (15).

        config SYS_EVENT_SYS_TASK_STACK
            int "Task stack (bytes)"
            default 4096
            range 3072 32768
            help
              Runs the queued listeners of the system's events (the power
              manager's own, the sessions') and their deferred ones.

    endmenu

    menu "Lane DEVICE"

        config SYS_EVENT_DEVICE_QUEUE_BYTES
            int "Queue (bytes)"
            default 1024
            range 256 16384
            help
              Room of the lane's ring buffer for its events waiting for its
              task (for its queued listeners, its events from ISRs and its
              deferred publishes). An event takes the buffer's 8 B, its own
              4 B, its 20 B header and its payload. A multiple of 4. A full
              buffer drops the event.

        config SYS_EVENT_DEVICE_TASK_PRIO
            int "Task priority"
            default 6
            range 1 24
            help
              Above the router work task (5), below the system lane (7).

        config SYS_EVENT_DEVICE_TASK_STACK
            int "Task stack (bytes)"
            default 4096
            range 3072 32768
            help
              Runs the queued listeners of the devices' events (the power
              manager, sys_device_remote) and every listener of an ISR
              or deferred device event: device ON_EVENT ops (I2C).

    endmenu

endmenu
```

## _SOFTWARE/runit-esp/components/sys/sys_log/Kconfig
```kconfig
menu "sys_log"

    config SYS_LOG_ERRORS_KEPT
        int "Error history capacity"
        default 16
        range 1 64
        help
          How many recent error records (up to SYS_LOG_RECORD_MAX bytes each)
          are kept in memory for LOG_OP_ERRORS; older ones are overwritten.

endmenu
```

## _SOFTWARE/runit-esp/components/sys/sys_session/Kconfig
```kconfig
menu "sys_session"

    config SYS_SESSION_MAX
        int "Sessions"
        default 4
        range 1 16
        help
          Sessions: providers with a peer on them, a board or a client.

    config SYS_SESSION_PORTS
        int "Sub-ports of a session"
        default 4
        range 1 16
        help
          The modules one session shows in the data matrix (ATTACH's list:
          the commands, MODULE_ID_ROUTER, and the streams). Each is a port of
          the data matrix (DATA_MATRIX_PORTS).

endmenu
```

## _SOFTWARE/runit-esp/components/sys/wireless/sys_ble/Kconfig
```kconfig
menu "sys_ble"

    config SYS_BLE_DEVICE_NAME
        string "Device name"
        default "runit"
        help
          The GAP name the board advertises.

    config SYS_BLE_TASK_PRIO
        int "BLE task priority"
        default 5
        range 1 24
        help
          The task that sends the queued items and applies the staged GATT changes.

    config SYS_BLE_TASK_STACK
        int "BLE task stack (bytes)"
        default 4096
        range 2048 32768

    config SYS_BLE_FIRST_WRITE_MS
        int "Time a client has to write after it connects (ms)"
        default 3000
        range 500 30000
        help
          A central that connects and writes nothing for this long is dropped, so the board advertises again: the
          PC's Bluetooth reconnects on its own for an app that is gone, and keeps the board from being found.

    config SYS_BLE_APPLY_DELAY_MS
        int "Apply delay with a client connected (ms)"
        default 200
        range 0 5000
        help
          APPLY with a client connected waits this long, so the command that asked for it is answered before the
          Service Changed indication.

endmenu
```
