## _SOFTWARE/legacy/components/system/ble/Kconfig
```kconfig
menu "BLE Manager Options"
    config SYS_BLE_MANAGER_TASK_PRIO
        int "BLE Manager Task Priority"
        default 5
        range 1 24
        help
          Priority of the BLE manager task.

    config SYS_BLE_TASK_STACK_SIZE
        int "BLE Task Stack Size (bytes)"
        default 4096
        range 1024 32768
        help
          Stack size in bytes for the BLE manager task.

    config SYS_BLE_GAP_APPEARANCE
        hex "GAP Appearance Value"
        default 0x0200
        range 0x0000 0xFFFF
        help
          GAP appearance value advertised in the BLE advertising fields
          (0x0200 = Generic Tag).

    config SYS_BLE_MAX_LINKED_CONNECTORS
        int "Maximum Linked Connectors per Characteristic"
        default 2
        range 1 8
        help
          Maximum number of data connectors that can be linked to a
          single BLE characteristic.
endmenu
```

## _SOFTWARE/legacy/components/system/sys_data_connector/Kconfig
```kconfig
menu "System Data Connector Options"
    config SYS_DATA_CONNECTOR_MAX
        int "Maximum Connectors in Registry"
        default 8
        range 1 32
        help
          Maximum number of data connectors in the system registry.

    config SYS_DATA_PROVIDER_MAX
        int "Maximum Providers in Registry"
        default 8
        range 1 32
        help
          Maximum number of transport providers in the registry.

    config SYS_DATA_CONNECTOR_PROVIDERS_MAX
        int "Maximum Providers per Connector (TX/RX)"
        default 4
        range 1 16
        help
          Maximum number of providers that can be attached to a single connector
          for fan-out (TX) or fan-in (RX).

    config SYS_DATA_CONNECTOR_NAME_MAX
        int "Maximum Connector Name Length"
        default 16
        range 8 64
        help
          Maximum length of diagnostic name string per connector.

    config SYS_DATA_CONNECTOR_FRAME_MAX
        int "Maximum Frame Length (bytes)"
        default 512
        range 64 4096
        help
          Largest frame any connector carries in either direction, including
          the outbound stream byte. Every frame buffer on the path (connector
          send, sys_interface RX, recorded actions) is statically sized to it.
          The limit used at runtime is smaller when a transport reports one
          (BLE: the negotiated MTU - 3); see sys_data_connector_max_payload().
endmenu
```

## _SOFTWARE/legacy/components/system/sys_uart/Kconfig
```kconfig
menu "UART Console Link"
    config SYS_UART_TASK_PRIO
        int "UART RX Task Priority"
        default 5
        range 1 24
        help
          Priority of the task that reads the console UART and de-frames
          "#R:" hex lines into data connector frames.

    config SYS_UART_TASK_STACK_SIZE
        int "UART RX Task Stack Size (bytes)"
        default 3072
        range 2048 16384
        help
          Stack size in bytes of the UART RX task. The line buffer is static,
          not on this stack.

    config SYS_UART_DRIVER_RX_BUF
        int "UART Driver RX Buffer (bytes)"
        default 1024
        range 256 8192
        help
          RX ring buffer of the UART driver installed on the console UART.
          Must be larger than the hardware FIFO (128 bytes).

    config SYS_UART_RX_QUEUE_SIZE
        int "Decoded Frame Queue Size (bytes)"
        default 2048
        range 512 16384
        help
          Ring buffer holding decoded frames until the bound connector's
          consumer dequeues them. Must be a multiple of 4.
endmenu
```

## _SOFTWARE/main/Kconfig.projbuild
```kconfig
menu "runIT"

    config RUNIT_BLE_START
        bool "Start BLE at boot"
        default y
        help
          Off for QEMU: it emulates no Bluetooth controller (the controller
          init asserts). The runIT GATT table, the BLE router link and the BLE
          stream bindings are still set up; only NimBLE is not started.
          sdkconfig.qemu.defaults turns it off for the QEMU build.

endmenu
```

## _SOFTWARE/runit-esp/components/app/runit/Kconfig
```kconfig
menu "runIT"

    config RUNIT_BLE_START
        bool "Start BLE at boot"
        default y
        help
          Off for QEMU: it emulates no Bluetooth controller (the controller
          init asserts). The runIT GATT table, the BLE router link and the BLE
          stream bindings are still set up; only NimBLE is not started.
          sdkconfig.qemu.defaults turns it off for the QEMU build.

    choice RUNIT_LINK_ROLE
        prompt "Link to another board"
        default RUNIT_LINK_NONE
        help
          What the sys_uart link (a second UART, CONFIG_SYS_UART_LINK_*) is in
          the tree of boards (SYS_SESSION.MD). A board with a parent takes no
          client: a child has no console or BLE session of its own, the app
          reaches it through the root.

        config RUNIT_LINK_NONE
            bool "None"
            help
              No link: the board is alone and takes clients (the app, the
              test scripts) on the console and on BLE.

        config RUNIT_LINK_ROOT
            bool "Root: the link leads to a child"
            select SYS_UART_LINK
            help
              The board stays the root and takes its clients; the link is a
              child session. The child's board id must differ from this
              board's (sdkconfig.link_root.defaults).

        config RUNIT_LINK_CHILD
            bool "Child: the link leads to the parent"
            select SYS_UART_LINK
            help
              The link is the board's parent session; no client session is
              attached. Give the board an id of its own
              (CONFIG_SYS_SESSION_BOARD_ID_DEFAULT; sdkconfig.link_child.defaults).
    endchoice

endmenu
```

## _SOFTWARE/runit-esp/components/core/errors/Kconfig
```kconfig
menu "Errors"

    config ERRORS_INFO_FILE
        bool "Record file name in errors"
        default y
        help
          Store the source file name (__FILE_NAME__, without the path) of the
          place an error was created. Costs one string per source file in
          flash.

    config ERRORS_INFO_FUNC
        bool "Record function name in errors"
        default y
        help
          Store the name of the function (__func__) that created the error.
          Costs one string per function that creates errors, in flash.

    config ERRORS_INFO_LINE
        bool "Record line number in errors"
        default y
        help
          Store the source line (__LINE__) where the error was created.

    config ERRORS_INFO
        bool
        default y if ERRORS_INFO_FILE || ERRORS_INFO_FUNC || ERRORS_INFO_LINE
        help
          Derived, not user-visible: on when any ERRORS_INFO_* option is on.
          When off, error nodes have no `info` field at all.

    config ERRORS_POOL_BLOCKS
        int "Error pool: number of blocks"
        default 32
        range 4 255
        help
          How many error nodes can exist at once (one node = one block).
          RAM used = ERRORS_POOL_BLOCKS * ERRORS_POOL_BLOCK_SIZE.

    config ERRORS_POOL_BLOCK_SIZE
        int "Error pool: block size (bytes)"
        default 32
        range 16 128
        help
          Size of one block = node header (13 B with info, 9 B without) +
          largest payload. Must be a multiple of 4.

    config ERRORS_LOG_LINE_LEN
        int "Error log: line buffer size (bytes)"
        default 256
        range 64 512
        help
          Size of the stack buffer err_log() formats one chain node into.
          Longer lines are cut.

    config ERRORS_MAX_MODULES
        int "Maximum error modules"
        default 32
        range 1 255
        help
          How many modules can register an error tag table
          (ERR_MODULE_DEFINE). One pointer of RAM per slot.

endmenu
```

## _SOFTWARE/runit-esp/components/core/router/Kconfig
```kconfig
menu "router"

    config ROUTER_MAX_KEYS
        int "Root keys"
        default 16
        range 2 64
        help
          Root table slots (router_register).

    config ROUTER_WORK_QUEUE_SIZE
        int "Work queue (bytes)"
        default 4096
        range 1024 32768
        help
          Ring buffer of normal commands waiting for the work task: each takes
          its request, a 12-byte header (answer callback, its ctx, origin) and
          the ring's own header. Multiple of 4.

    config ROUTER_URGENT_QUEUE_SIZE
        int "Urgent queue (bytes)"
        default 1024
        range 256 8192
        help
          Ring buffer of commands flagged urgent. Multiple of 4.

    config ROUTER_WORK_TASK_PRIO
        int "Work task priority"
        default 5
        range 1 24

    config ROUTER_WORK_TASK_STACK
        int "Work task stack (bytes)"
        default 6144
        range 3072 32768
        help
          Runs the module routers of normal commands and their answer
          callbacks (the session's framer).

    config ROUTER_URGENT_TASK_PRIO
        int "Urgent task priority"
        default 15
        range 1 24
        help
          Above every task that may run a long command, so an urgent one
          (stop) never waits behind it.

    config ROUTER_URGENT_TASK_STACK
        int "Urgent task stack (bytes)"
        default 6144
        range 3072 32768
        help
          Runs urgent commands and router_run_urgent (the safe-state
          handler on a dead-man).

endmenu
```

## _SOFTWARE/runit-esp/components/sys/sys_actions/Kconfig
```kconfig
menu "sys_actions"

    config SYS_ACTIONS_PARTITION
        string "NVS partition"
        default "project"
        help
          NVS data partition (partitions.csv) whose "actions" namespace holds
          the stored records, one blob (the image) per record, key "a<id>" with
          the 32-bit ID as 8 hex digits.

    config SYS_ACTIONS_MAX_BYTES
        int "Largest record (bytes)"
        default 4096
        range 256 16384
        help
          Largest image (frames with their u16 length). Also the most heap a
          record takes while it is written.

    config SYS_ACTIONS_MAX_DEPTH
        int "Nested runs"
        default 3
        range 1 8
        help
          How deep a RUN inside an action may nest. Each level holds its image
          and a router frame of heap, and a few hundred bytes of the router
          task's stack.

endmenu
```

## _SOFTWARE/runit-esp/components/sys/sys_ble/Kconfig
```kconfig
menu "sys_ble"

    config SYS_BLE_DEVICE_NAME
        string "Device name"
        default "runit"
        help
          GAP name the board advertises.

    config SYS_BLE_GAP_APPEARANCE
        hex "GAP appearance"
        default 0x0200
        range 0x0000 0xFFFF
        help
          Appearance value in the advertising data (0x0200 = Generic Tag).

    config SYS_BLE_TASK_PRIO
        int "BLE task priority"
        default 5
        range 1 24
        help
          Task that sends queued TX items (notifications / indications) and
          applies staged GATT changes.

    config SYS_BLE_TASK_STACK
        int "BLE task stack (bytes)"
        default 4096
        range 2048 32768

    config SYS_BLE_APPLY_DELAY_MS
        int "Apply delay with a client connected (ms)"
        default 200
        range 0 5000
        help
          sys_ble_apply() with a client connected waits this long, so the
          command that asked for it is answered before the Service Changed
          indication.

    config SYS_BLE_USER_PROVIDERS
        int "Providers of run-time characteristics"
        default 2
        range 0 8
        help
          A characteristic made at run time (CHAR_CREATE) that is unframed
          and writes with no RX buffer, or has a TX buffer, is a data
          provider (SYS_DATA_PROVIDER.MD), named {BLE, its UUID}. This many
          can exist at once; they also take slots of CONFIG_SYS_DATA_PROVIDER_MAX.

    config SYS_BLE_CENTRAL_LINKS
        int "Links to other boards (central)"
        default 2
        range 0 2
        help
          Boards this board connects to as a BLE central (CONNECT), each a
          framed provider over that board's runIT pair. Nothing is
          allocated until the first CONNECT. With the app's connection
          they share CONFIG_BT_NIMBLE_MAX_CONNECTIONS.

    config SYS_BLE_CENTRAL_FOUND_MAX
        int "Boards a scan keeps"
        default 8
        range 1 16
        help
          runIT boards a SCAN lists (FOUND); more are not kept.

    config SYS_BLE_MAX_CONN_LISTENERS
        int "Connection listeners"
        default 4
        range 1 16

    config SYS_BLE_ANSWER_WAIT_MS
        int "Send wait (ms)"
        default 100
        range 1 5000
        help
          How long a provider's send without NOWAIT (an answer) waits for room
          in its characteristic's buffer, then ERR_PROV_BUSY. A NOWAIT send (a
          PUSH frame) is ERR_PROV_BUSY at once.

endmenu
```

## _SOFTWARE/runit-esp/components/sys/sys_connector/Kconfig
```kconfig
menu "sys_connector"

    config SYS_CONNECTOR_MAX
        int "Connectors"
        default 8
        range 5 32
        help
          Registry slots: the 4 system connectors (logs, errors, telemetry,
          events) and the user connectors.

    config SYS_CONNECTOR_BINDINGS
        int "Bindings per connector"
        default 3
        range 1 8

    config SYS_CONNECTOR_PROVIDERS_MAX
        int "Highest provider ID"
        default 4
        range 2 16
        help
          Providers register under their transport ID 1..this.

    config SYS_CONNECTOR_FRAME_MAX
        int "Largest frame (bytes)"
        default 512
        range 64 4096
        help
          Largest frame (connector byte included) a connector sends.

    config SYS_CONNECTOR_QUEUE_SIZE
        int "Queue (bytes)"
        default 4608
        range 1024 32768
        help
          Ring buffer of frames waiting for the connector task; each takes
          its length + ~12 bytes, and the frame being sent keeps its room
          until every binding has it. A full queue drops sends. Multiple of 4.

    config SYS_CONNECTOR_TASK_PRIO
        int "Task priority"
        default 4
        range 1 24
        help
          Below the router tasks: streams wait, commands don't.

    config SYS_CONNECTOR_TASK_STACK
        int "Task stack (bytes)"
        default 4096
        range 2048 32768

endmenu
```
