## _SOFTWARE/runit-esp/components/sys/sys_uart/Kconfig
```kconfig
menu "sys_uart"

    config SYS_UART_TASK_PRIO
        int "RX task priority"
        default 5
        range 1 24
        help
          Priority of the task that reads the console UART (and USB-Serial-JTAG)
          and hands each frame (COBS, CRC16 checked) to the provider's user.

    config SYS_UART_TASK_STACK
        int "RX task stack (bytes)"
        default 4096
        range 2048 16384
        help
          The frame buffers are static, not on this stack. The session's
          handling of a hello or a lost child runs on it.

    config SYS_UART_DRIVER_RX_BUF
        int "Driver RX buffer (bytes)"
        default 1024
        range 256 8192
        help
          RX buffer of the UART (and USB-Serial-JTAG) driver installed on the
          console. Must be larger than the UART hardware FIFO (128 bytes).

    config SYS_UART_TX_QUEUE
        int "TX queue (bytes)"
        default 8192
        range 1024 32768
        help
          Frames waiting for the TX task (answers, PUSH frames); each takes
          its length and CRC (2) rounded to 4, + 8 bytes. Urgent frames have a queue of
          their own, written first. Larger than the stream queue
          (CONFIG_SYS_STREAM_QUEUE_SIZE), so a burst of PUSH frames
          fills that one first and its producer is refused (and resends), not
          lost here unseen. Multiple of 4.

    config SYS_UART_TX_TASK_PRIO
        int "TX task priority"
        default 2
        range 1 24
        help
          The task that encodes the queued frames and writes them. Low: the
          console is slow, and nothing waits for it but the queue.

    config SYS_UART_TX_TASK_STACK
        int "TX task stack (bytes)"
        default 3072
        range 2048 16384

    config SYS_UART_SEND_WAIT_MS
        int "Send wait (ms)"
        default 1000
        range 10 10000
        help
          How long a send without NOWAIT (an answer) waits for room in the TX
          queue, then ERR_PROV_BUSY; a NOWAIT send (a PUSH frame) is
          ERR_PROV_BUSY at once. Also how long a frame waits for the
          USB-Serial-JTAG host.

    config SYS_UART_PORT_RX_BUF
        int "RX buffer of a port (bytes)"
        default 4096
        range 256 16384
        help
          The UART driver's RX buffer of the link and of every port CREATE
          makes. Larger than the console's: a flash write stops the RX task
          for milliseconds, and at a high rate the buffer fills in that time.

    config SYS_UART_LINK
        bool "Board-to-board link"
        default y
        help
          A second UART as a provider, for a cable to another runIT board's
          console UART (UART0, the pins its ROM bootloader listens on): the
          same line format as the console (COBS and CRC16), wired, with its
          own rings and tasks. runIT attaches it as a slave's session
          (SYS_SESSION.MD), and sys_flasher borrows its pins to program the
          board on it.

    config SYS_UART_LINK_PORT
        int "Link UART port"
        depends on SYS_UART_LINK
        default 1
        range 1 2
        help
          The UART of the link; not the console's.

    config SYS_UART_LINK_TX_PIN
        int "Link TX pin (GPIO)"
        depends on SYS_UART_LINK
        default 18
        range 0 48
        help
          Joined to the other board's U0RXD (GPIO 44 of an ESP32-S3). 17 and
          18 are free on the ESP32-S3 devkit and on the runIT board's GPIO header.

    config SYS_UART_LINK_RX_PIN
        int "Link RX pin (GPIO)"
        depends on SYS_UART_LINK
        default 17
        range 0 48
        help
          Joined to the other board's U0TXD (GPIO 43). The grounds are joined too.

    config SYS_UART_LINK_RTS_PIN
        int "Link RTS pin (GPIO, -1 = none)"
        depends on SYS_UART_LINK
        default -1
        range -1 48
        help
          With the CTS pin also set the link uses hardware flow control.

    config SYS_UART_LINK_CTS_PIN
        int "Link CTS pin (GPIO, -1 = none)"
        depends on SYS_UART_LINK
        default -1
        range -1 48

    config SYS_UART_LINK_BAUD
        int "Link baud rate"
        depends on SYS_UART_LINK
        default 921600
        range 115200 5000000
        help
          The other board's console rate (CONFIG_ESP_CONSOLE_UART_BAUDRATE):
          the same firmware, so the same number. Jumper wires and long cables want the
          lower end; 2 to 5 Mbaud needs a short cable and, on a board that
          writes flash (NVS) while frames arrive, the ISR in IRAM
          (CONFIG_UART_ISR_IN_IRAM) or flow control.

endmenu
```
