## _SOFTWARE/runit-esp/components/sys/sys_data_connector/Kconfig
```kconfig
menu "sys_data_connector"

    config SYS_DATA_CONNECTOR_MAX
        int "Connectors"
        default 16
        range 5 32
        help
          Registry slots: the 5 system connectors (logs, errors, telemetry,
          events, all events), the user connectors and the mirrors (sys_remote
          makes two per board that has a remote device).

    config SYS_DATA_CONNECTOR_BINDINGS
        int "Bindings per connector"
        default 3
        range 1 8

    config SYS_DATA_CONNECTOR_SUBSCRIBERS
        int "Subscribers per connector"
        default 4
        range 1 8
        help
          Peers subscribed to one connector (SUBSCRIBE): the app, a test host.

    config SYS_DATA_CONNECTOR_BUF_POOL
        int "Receive buffers (bytes)"
        default 2048
        range 0 16384
        help
          The buffers of every connector that keeps what comes in (LATEST: one
          message, FIFO: a ring), taken at create from one static pool and
          given back at remove. A create that does not fit: ERR_CONN_POOL_FULL.

    config SYS_DATA_CONNECTOR_QUEUE_SIZE
        int "Queue (bytes)"
        default 4608
        range 1024 32768
        help
          Ring buffer of frames waiting for the connector task; each takes
          its length + ~12 bytes, and the frame being sent keeps its room
          until every target has it. A full queue drops sends. Multiple of 4.

    config SYS_DATA_CONNECTOR_TASK_PRIO
        int "Task priority"
        default 4
        range 1 24
        help
          Below the router tasks: streams wait, commands don't.

    config SYS_DATA_CONNECTOR_TASK_STACK
        int "Task stack (bytes)"
        default 4096
        range 2048 32768
        help
          Holds a whole stream frame (CMD_FRAME_MAX) while it goes to a
          subscriber.

endmenu
```

## _SOFTWARE/runit-esp/components/sys/sys_data_provider/Kconfig
```kconfig
menu "sys_data_provider"

    config SYS_DATA_PROVIDER_MAX
        int "Providers"
        default 8
        range 2 32
        help
          Provider slots, the board's own included (the runIT BLE pair, the
          LOGS characteristic, the UART console).

endmenu
```

## _SOFTWARE/runit-esp/components/sys/sys_event/Kconfig
```kconfig
menu "sys_event"

    config SYS_EVENT_MAX_SUBS
        int "Subscriptions (C)"
        default 32
        range 4 255
        help
          Listeners made by C code: devices (inline) and functions (the VM,
          the power manager; the event task).

    config SYS_EVENT_QUEUE_LEN
        int "Queue (events)"
        default 16
        range 4 128
        help
          Events waiting for the event task (for the function listeners,
          events from ISRs and deferred publishes). A full queue drops the event.

    config SYS_EVENT_TASK_PRIO
        int "Task priority"
        default 6
        range 1 24
        help
          Above the router work task (5), below the urgent task (15).

    config SYS_EVENT_TASK_STACK
        int "Task stack (bytes)"
        default 4096
        range 3072 32768
        help
          Runs the function listeners (the VM, the power manager) and every
          listener of an ISR or deferred event: device ON_EVENT ops (I2C).

endmenu
```

## _SOFTWARE/runit-esp/components/sys/sys_flasher/Kconfig
```kconfig
menu "sys_flasher"

    config SYS_FLASHER_EN_PIN
        int "EN wire (GPIO)"
        default 3
        range 0 48
        help
          Joined to the EN (RST) pin of the board on the link. Driven push-pull:
          low resets that board, high keeps it running. Its RST button is not
          used while this wire is joined.

    config SYS_FLASHER_BOOT_PIN
        int "BOOT wire (GPIO)"
        default 46
        range 0 48
        help
          Joined to GPIO 0 (BOOT) of the board on the link. Low while EN
          rises starts that board's ROM bootloader. Push-pull, as EN.

    config SYS_FLASHER_BAUD
        int "Rate while flashing"
        default 921600
        range 115200 2000000
        help
          The ROM bootloader starts at 115200; CHANGE_BAUD takes it to this
          rate for the writes.

    config SYS_FLASHER_TASK_STACK
        int "Task stack (bytes)"
        default 4096
        range 3072 16384

    config SYS_FLASHER_TASK_PRIO
        int "Task priority"
        default 3
        range 1 10
        help
          Below the router's and the stream's tasks: flashing waits on the
          line, and nothing waits on it.

endmenu
```

## _SOFTWARE/runit-esp/components/sys/sys_i2c/Kconfig
```kconfig
menu "sys_i2c"

    config SYS_I2C_XFER_TIMEOUT_MS
        int "Transfer timeout (ms)"
        default 50
        range 5 5000
        help
          Timeout of one transfer (write, read, write-read), including the wait
          for the bus lock when another task is using the bus.

    config SYS_I2C_PROBE_TIMEOUT_MS
        int "Probe timeout (ms)"
        default 50
        range 5 5000
        help
          Timeout of the address probe done by sys_i2c_dev_add() and
          sys_i2c_probe().

    config SYS_I2C_GLITCH_IGNORE_CNT
        int "Glitch filter (I2C module clock cycles)"
        default 7
        range 0 7
        help
          Pulses on SDA/SCL shorter than this are ignored. Applies to both buses.

endmenu
```

## _SOFTWARE/runit-esp/components/sys/sys_log/Kconfig
```kconfig
menu "sys_log"

    config SYS_LOG_LINE_MAX
        int "Captured log line (bytes)"
        default 160
        range 32 480
        help
          Log lines sent to the logs connector are cut to this. Formatted on
          the stack of the task that logs.

    config SYS_LOG_ERRORS_KEPT
        int "Error records kept for the app"
        default 16
        range 1 64
        help
          The latest error records (each up to SYS_LOG_RECORD_MAX bytes) are kept in RAM so the app can read what happened before
          it connected. A restart empties them.

endmenu
```

## _SOFTWARE/runit-esp/components/sys/sys_lvgl/Kconfig
```kconfig
menu "sys_lvgl"

    config SYS_LVGL_HEAP_DEFAULT
        int "LVGL's pool at INSTALL (B)"
        default 65536
        range 32768 4194304
        help
          LVGL's one pool when INSTALL gives 0: every object, style and
          cache of the screen. Taken whole at INSTALL, freed at RESET.

    config SYS_LVGL_POOL_RESERVE
        int "Pool reserve (B)"
        default 8192
        range 2048 65536
        help
          What sys_lvgl_pool_check keeps free in LVGL's pool for what LVGL
          allocates by itself while it draws (layers, label lines). A widget
          that would eat into it is refused (ERR_LVGL_POOL_FULL).

    config SYS_LVGL_BUFFER_MAX
        int "Largest draw buffer (B)"
        default 32768
        range 1024 262144
        help
          One draw buffer at most (two are made). Also limited by the
          display's largest FLUSH (GEOMETRY flush_max).

    config SYS_LVGL_FLUSH_TIMEOUT_MS
        int "FLUSH limit (ms)"
        default 200
        range 20 5000
        help
          The longest wait for the end of a FLUSH; past it the adapter reports
          ERR_DISPLAY_FLUSH_TIMEOUT and resets the display.

    config SYS_LVGL_HEALTH_MS
        int "Display check period (ms)"
        default 1000
        range 0 60000
        help
          How often the adapter reads its display's HEALTH while it draws
          (a display whose SDO is wired, SYS_DISPLAY_FLAG_READABLE): no
          answer is reported once (ERR_DISPLAY_LOST) and the screen redrawn
          when it answers again; a panel that lost its power is reset and
          redrawn. 0: never.

    config SYS_LVGL_TASK_STACK
        int "LVGL task stack (B)"
        default 8192
        range 4096 32768

    config SYS_LVGL_TASK_PRIO
        int "LVGL task priority"
        default 4
        range 1 20

endmenu
```

## _SOFTWARE/runit-esp/components/sys/sys_remote/Kconfig
```kconfig
menu "sys_remote"

    config SYS_REMOTE_WATCH_MS
        int "Remote read period (ms)"
        default 100
        range 10 60000
        help
          A remote device that is not wired is read from a watch's copy: the
          first read makes an ON_CHANGE watch on its board, which reads every
          this long and sends at least every twice this long.

    #@limit @alias Remote subscriptions
    config SYS_REMOTE_SUBSCRIPTIONS
        int "Subscriptions to this board's devices"
        default 16
        range 1 64
        help
          Peers subscribed to a device of this board (SUBSCRIBE): each gets the
          device's events and errors. Another board's remote device takes one.

    config SYS_REMOTE_ALIASES
        int "Remote devices with events"
        default 16
        range 1 64
        help
          Remote devices of this board whose events and errors come here: the
          board, the id there and the count of the frames that came.

    config SYS_REMOTE_QUEUE_SIZE
        int "Queue (bytes)"
        default 1024
        range 256 8192
        help
          The events and errors on their way: out to the subscribers of this
          board's devices, and in from the boards of the remote devices. A
          multiple of 4.

    config SYS_REMOTE_TASK_PRIO
        int "Task priority"
        default 4
        range 1 20

    config SYS_REMOTE_TASK_STACK
        int "Task stack (bytes)"
        default 4096
        range 2048 16384

endmenu
```

## _SOFTWARE/runit-esp/components/sys/sys_session/Kconfig
```kconfig
menu "sys_session"

    config SYS_SESSION_MAX
        int "Sessions"
        default 4
        range 1 16
        help
          Providers attached to a peer: a parent, children, the root's clients.

    #@limit @alias Calls to other boards
    config SYS_SESSION_CALLS
        int "Calls in flight"
        default 32
        range 1 64
        help
          The board's own requests to other boards waiting for an answer
          (sys_session_call); a call to this board takes none. Every call to
          another board is answered, so each write of a remote device in
          flight takes one.

    config SYS_SESSION_PEER_IN_FLIGHT
        int "Calls in flight to one board"
        default 4
        range 1 16
        help
          Calls to one board on the way at once; one more is ERR_SESSION_BUSY
          (no failure: the caller sends it later). Keeps a fast caller from
          queuing a backlog on a slow link.

    #@limit @alias Call timeout @unit ms
    config SYS_SESSION_CALL_TIMEOUT_MS
        int "Call timeout (ms)"
        default 1000
        range 50 10000
        help
          A call without an answer this long ends with ERR_SESSION_TIMEOUT:
          over a radio (BLE, MQTT, ESP-NOW) or further than a neighbour.
          Longer than a radio's tail, so a slow answer is not taken for a
          lost one.

    #@limit @alias Wired call timeout @unit ms
    config SYS_SESSION_CALL_TIMEOUT_WIRED_MS
        int "Wired call timeout (ms)"
        default 50
        range 10 1000
        help
          The same to the peer of a session on a WIRED provider (a cable):
          its round trip is about a millisecond.

    config SYS_SESSION_GONE_LISTENERS
        int "Gone-peer listeners"
        default 5
        range 1 8
        help
          sys_session_on_gone and sys_session_on_reached slots, each: the
          connectors, the watches, the dead-man.

    config SYS_SESSION_STREAM_LISTENERS
        int "Stream listeners"
        default 2
        range 1 4
        help
          sys_session_on_stream slots.

    config SYS_SESSION_TIME_PERIOD_S
        int "Time broadcast period (s)"
        default 60
        range 5 3600
        help
          The root sends its time to every board this often (and when a
          client sets it), so the clocks of all boards are the root's.

    #@limit @alias Session timeout @unit ms
    config SYS_SESSION_TIMEOUT_MS
        int "Session timeout (ms)"
        default 3000
        range 150 60000
        help
          A child's session with nothing received for this long ends: its
          calls fail, its peers are gone, the hello starts again. The hello
          tells the peer, which sends at least every third of it. The parent's
          and the clients' sessions take the dead-man's time instead
          (sys_session_set_timeout).

endmenu
```

## _SOFTWARE/runit-esp/components/sys/sys_stream/Kconfig
```kconfig
menu "sys_stream"

    config SYS_STREAM_MAX
        int "Streams"
        default 12
        range 4 32
        help
          Registry slots: the 4 system streams (logs, errors, telemetry,
          events) and the user streams.

    config SYS_STREAM_TARGETS
        int "Targets per stream"
        default 6
        range 1 16
        help
          One list per stream: its bindings to providers, its subscribed
          peers (the app, a test host, another board) and its callbacks.

    config SYS_STREAM_QUEUE_SIZE
        int "Queue (bytes)"
        default 4608
        range 1024 32768
        help
          Ring buffer of frames waiting for the stream task: sends of OUT
          streams and what came in on IN streams. Each takes its length +
          ~12 bytes, and the frame being sent keeps its room until every
          target has it. A full queue drops it. Multiple of 4.

    config SYS_STREAM_TASK_PRIO
        int "Task priority"
        default 4
        range 1 24
        help
          Below the router tasks: streams wait, commands don't.

    config SYS_STREAM_TASK_STACK
        int "Task stack (bytes)"
        default 4096
        range 2048 32768
        help
          Holds a whole PUSH frame (CMD_FRAME_MAX) while it goes to a
          subscriber.

endmenu
```

## _SOFTWARE/runit-esp/components/sys/sys_system/Kconfig
```kconfig
menu "sys_system"

    config SYS_SYSTEM_DEADMAN_DEFAULT_MS
        int "Dead-man timeout at boot (ms, 0 = off)"
        default 0
        range 0 60000
        help
          0, or the clients' sessions' timeout (150..60000): their end enters
          the safe state. Changed at runtime with the sys DEADMAN command;
          not stored.

endmenu
```
